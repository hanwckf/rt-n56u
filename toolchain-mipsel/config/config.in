## toolchain-mipsel/config/config.in
```kconfig
mainmenu "crosstool-NG $CT_VERSION Configuration"
source "config/configure.in"
source "config/global.in"
source "config/target.in"
source "config/toolchain.in"
source "config/kernel.in"
source "config/binutils.in"
source "config/libc.in"
source "config/cc.in"
source "config/debug.in"
source "config/comp_libs.in"
source "config/comp_tools.in"
source "config/test_suite.in"
```
