## trunk/linux-3.0.x/arch/mips/rt2880/Kconfig
```kconfig
if RALINK_RT2880

choice
	prompt "SoC Hardware Type"
	default RT2880_ASIC

config  RT2880_ASIC
	bool "RT2880-ASIC"
endchoice

endif

#---------------------------

if RALINK_RT3052

choice
	prompt "SoC Hardware Type"
	default RT3052_ASIC

config  RT3052_ASIC
	bool "RT305x/RT3350-ASIC"
endchoice

config RALINK_RT3350
	bool "Ralink RT3350 chipset"

endif

#---------------------------

if RALINK_RT3352

choice
	prompt "SoC Hardware Type"
	default RT3352_ASIC

config  RT3352_ASIC
	bool "RT3352-ASIC"
	select USB_ARCH_HAS_OHCI
	select USB_ARCH_HAS_EHCI
endchoice

endif

#---------------------------

if RALINK_RT2883

choice
	prompt "SoC Hardware Type"
	default RT2883_ASIC

config  RT2883_ASIC
	bool "RT2883-ASIC"
endchoice

endif

#--------------------------

if RALINK_RT3883

choice
	prompt "SoC Hardware Type"
	default RT3883_ASIC

config  RT3883_ASIC
	bool "RT3883/RT3662-ASIC"
	select USB_ARCH_HAS_OHCI
	select USB_ARCH_HAS_EHCI
endchoice

choice
	prompt "RT3883/RT3662 PCI architecture"
	default PCIE_PCI_CONCURRENT

config PCIE_PCI_CONCURRENT
	bool "PCIE RC and PCI HOST CONCURRENT"
config PCIE_ONLY
	bool "PCIE RC ONLY"
config PCI_ONLY
	bool "PCI HOST ONLY"
config PCIE_PCI_NONE
	bool "Non-support PCI/PCIe"
endchoice

endif

#---------------------------

if RALINK_RT5350

choice
	prompt "SoC Hardware Type"
	default RT5350_ASIC

config  RT5350_ASIC
	bool "RT5350-ASIC"
	select USB_ARCH_HAS_OHCI
	select USB_ARCH_HAS_EHCI
endchoice

endif

#--------------------------

if RALINK_MT7620

choice
	prompt "SoC Hardware Type"
	default MT7620_ASIC

config  MT7620_ASIC
	bool "MT7620-ASIC"
	select USB_ARCH_HAS_OHCI
	select USB_ARCH_HAS_EHCI
endchoice

endif

#--------------------------

config  RALINK_CPUSLEEP_AND_SYSTICK_COUNTER
	bool "CPU Sleep mode and System Tick Counter Support"
	depends on RALINK_MT7620
	default n

#--------------------------

choice
	prompt "DRAM Size"
	default RT2880_DRAM_64M

config RT2880_DRAM_8M
	bool "8M"

config RT2880_DRAM_16M
	bool "16M"

config RT2880_DRAM_32M
	bool "32M"

config RT2880_DRAM_64M
	bool "64M"

config RT2880_DRAM_128M
	bool "128M"

config RT2880_DRAM_256M
	bool "256M"

endchoice

config RALINK_RAM_SIZE
	int
	default 8 if RT2880_DRAM_8M
	default 16 if RT2880_DRAM_16M
	default 32 if RT2880_DRAM_32M
	default 64 if RT2880_DRAM_64M
	default 128 if RT2880_DRAM_128M
	default 256 if RT2880_DRAM_256M

#--------------------------

choice
	prompt "UART Baud Rate"
	default RT2880_UART_57600

config RT2880_UART_57600
	bool "57600"

config RT2880_UART_115200
	bool "115200"

endchoice

config  RALINK_UART_BRATE
	int
	default 57600 if RT2880_UART_57600
	default 115200 if RT2880_UART_115200

#--------------------------

config  RALINK_TIMER_DFS
	tristate "Ralink DFS Timer"
	default n

config  RALINK_TIMER_WDG
	tristate "Ralink WatchDog Timer"
	default n

config  RALINK_TIMER_WDG_RESET_OUTPUT
	bool "Ralink WatchDog Reset Output GPIO Pin"
	depends on RALINK_TIMER_WDG
	default n

config  RALINK_TIMER_WDG_REBOOT_DELAY
	int "WatchDog Timer Reboot Delay (Unit:1Sec, Max=30Sec)"
	default 15
	depends on RALINK_TIMER_WDG

config  RALINK_TIMER_WDG_REFRESH_INTERVAL
	int "WatchDog Refresh Interval (Unit:1Sec, Max=30Sec)"
	default 4
	depends on RALINK_TIMER_WDG
```

## trunk/linux-3.0.x/drivers/flash/Kconfig
```kconfig
menu "Ralink Common Flash Driver (OBSOLETE)"

config RALINK_FLASH_API
	bool "Ralink Common Flash R/W API (OBSOLETE)"

comment "2MB Flash"

config FLASH_EN29LV160
	bool "EON      EN29LV160"
	depends on RALINK_FLASH_API

config FLASH_MX29LV160
	bool "Mxic     MX29LV160"
	depends on RALINK_FLASH_API

config FLASH_S29AL016X
	bool "Spansion S29AL016X"
	depends on RALINK_FLASH_API
config FLASH_K8D3X16U
	bool "Samsung  K8D3X16U"
	depends on RALINK_FLASH_API

comment "4MB Flash"

config FLASH_MX29LV320
	bool "Mxic     MX29LV320"
	depends on RALINK_FLASH_API

config FLASH_EN29LV320
	bool "EON      EN29LV320"
	depends on RALINK_FLASH_API

#config FLASH_SST39VF320X
#	bool "SST      SST39VF320X"
#	depends on RALINK_FLASH_API

config FLASH_S29AL032X
	bool "Spansion S29AL032X"
	depends on RALINK_FLASH_API

config FLASH_S29GL032N
	bool "Spansion S29GL032N"
	depends on RALINK_FLASH_API

config FLASH_F49L320
	bool "ESMT F49L320X"
	depends on RALINK_FLASH_API

comment "8MB Flash"

config FLASH_MX29LV640
	bool "Mxic     MX29LV640"
	depends on RALINK_FLASH_API

config FLASH_S29GL064N
	bool "Spansion S29GL064N"
	depends on RALINK_FLASH_API

comment "16MB Flash"
	
config FLASH_MX29LV128
	bool "Mxic     MX29LV128"
	depends on RALINK_FLASH_API

comment "32MB Flash"
	
config FLASH_S29GL256
	bool "Spansion S29GL256"
	depends on RALINK_FLASH_API

endmenu
```

## trunk/linux-3.0.x/drivers/mtd/ralink/Kconfig
```kconfig
menu "Ralink MTD support"

config MTD_RALINK
	bool "Ralink MTD support"
	default y
	depends on MTD

config MTD_NOR_RALINK
	bool "NOR Flash Support"
	default y
	depends on MTD_RALINK && (RALINK_RT3052 || RALINK_RT3883)

config MTD_SPI_RALINK
	bool "SPI Flash Support"
	depends on MTD_RALINK

config MTD_SPI_FAST_CLOCK
	bool "Use SPI fast clock, up to 50MHz"
	default n
	depends on MTD_SPI_RALINK

choice
	prompt "SPI Read Mode"
	default MTD_SPI_READ_NORM if !(RALINK_MT7621 || RALINK_MT7628)
	default MTD_SPI_READ_BUFF if  (RALINK_MT7621 || RALINK_MT7628)
	depends on MTD_SPI_RALINK

	config MTD_SPI_READ_NORM
		bool "Normal Read, opcode 0x03"
	config MTD_SPI_READ_FAST
		bool "Fast Read, opcode 0x0B"
	config MTD_SPI_READ_BUFF
		bool "Buffered Read"
		depends on (RALINK_MT7621 || RALINK_MT7628)
	config MTD_SPI_READ_DOR
		bool "Fast Read Dual Out, opcode 0x3B"
		depends on (RALINK_MT7620 || RALINK_MT7621 || RALINK_MT7628)
	config MTD_SPI_READ_DIOR
		bool "Fast Read Dual I/O, opcode 0xBB"
		depends on (RALINK_MT7620 || RALINK_MT7621 || RALINK_MT7628)
endchoice

config MTD_NAND_RALINK
	bool "NAND Flash Support"
	depends on MTD_RALINK && !(RALINK_RT3352 || RALINK_RT5350 || RALINK_MT7621 || RALINK_MT7628)

#config MTD_NAND_MTK
#	bool "NAND Flash Support"
#	depends on MTD_RALINK && (RALINK_MT7621)
#	select MTD_NAND
#	select MTD_NAND_IDS
#	select MTD_NAND_ECC

choice
	prompt "Flash Size"
	default RT2880_FLASH_AUTO

	config RT2880_FLASH_4M
		bool "4M"
		depends on (MTD_SPI_RALINK || MTD_NOR_RALINK)
	config RT2880_FLASH_8M
		bool "8M"
		depends on (MTD_SPI_RALINK || MTD_NOR_RALINK)
	config RT2880_FLASH_16M
		bool "16M"
		depends on (MTD_SPI_RALINK || MTD_NOR_RALINK)
	config RT2880_FLASH_32M
		bool "32M"
		depends on MTD_SPI_RALINK
	config RT2880_FLASH_AUTO
		bool "Autodetect Size"
endchoice

config RT2880_MTD_PHYSMAP_START
	hex
	default 0xBF000000 if RALINK_RT3052
	default 0x1FC00000 if RALINK_MT7621
	default 0x1C000000 if !RALINK_RT3052

config RT2880_MTD_PHYSMAP_LEN
	hex
	default 0x0400000 if RALINK_MT7621
	default 0x1000000 if !RALINK_MT7621

config RT2880_MTD_PHYSMAP_BUSWIDTH
	int
	default 2

choice
	prompt "Root File System Type"
	default RT2880_ROOTFS_IN_FLASH

	config  RT2880_ROOTFS_IN_RAM
		bool "RootFS_in_RAM"
		select BLK_DEV_INITRD
		select BLK_DEV_RAM

	config  RT2880_ROOTFS_IN_FLASH
		bool "RootFS_in_FLASH"
endchoice

config ROOTFS_IN_FLASH_NO_PADDING
	bool "No Padding between Kernel and RootFS"
	default y
	depends on RT2880_ROOTFS_IN_FLASH

config MTD_KERNEL_PART_SIZ
	hex 'MTD Kernel Partition Size (Unit:Bytes)'
	default 0xD0000
	depends on RT2880_ROOTFS_IN_FLASH && !ROOTFS_IN_FLASH_NO_PADDING

config MTD_STORE_PART_SIZ
	hex 'MTD Storage Partition Size (Unit:Bytes)'
	default 0x10000
	depends on MTD_RALINK

endmenu
```
