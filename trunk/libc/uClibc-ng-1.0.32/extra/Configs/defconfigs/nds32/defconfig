## trunk/linux-2.6.21.x/crypto/ocf/Kconfig
```kconfig
menu "OCF Configuration"

config OCF_OCF
	tristate "OCF (Open Cryptograhic Framework)"
	depends on !MIPS
	help
	  A linux port of the OpenBSD/FreeBSD crypto framework.

config OCF_RANDOMHARVEST
	tristate "crypto random --- harvest entropy for /dev/random"
	depends on OCF_OCF
	help
	  Includes code to harvest random numbers from devices that support it.

config OCF_FIPS
	tristate "enable fips RNG checks"
	depends on OCF_OCF && OCF_RANDOMHARVEST
	help
	  Run all RNG provided data through a fips check before
	  adding it /dev/random's entropy pool.

config OCF_CRYPTODEV
	tristate "cryptodev (user space support)"
	depends on OCF_OCF
	help
	  The user space API to access crypto hardware.

config OCF_CRYPTOSOFT
	tristate "cryptosoft (software crypto engine)"
	depends on OCF_OCF
	help
	  A software driver for the OCF framework that uses
	  the kernel CryptoAPI.

config OCF_SAFE
	tristate "safenet (HW crypto engine)"
	depends on OCF_OCF
	help
	  A driver for a number of the safenet Excel crypto accelerators.
	  Currently tested and working on the 1141 and 1741.

config OCF_IXP4XX
	tristate "IXP4xx (HW crypto engine)"
	depends on OCF_OCF
	help
	  XScale IXP4xx crypto accelerator driver.  Requires the
	  Intel Access library.

config OCF_HIFN
	tristate "hifn (HW crypto engine)"
	depends on OCF_OCF
	help
	  OCF driver for various HIFN based crypto accelerators.
	  (7951, 7955, 7956, 7751, 7811)

config OCF_HIFNHIPP
	tristate "Hifn HIPP (HW packet crypto engine)"
	depends on OCF_OCF
	help
	  OCF driver for various HIFN (HIPP) based crypto accelerators
	  (7855)

config OCF_TALITOS
	tristate "talitos (HW crypto engine)"
	depends on OCF_OCF
	help
	  OCF driver for Freescale's security engine (SEC/talitos).

config OCF_OCFNULL
	tristate "ocfnull (fake crypto engine)"
	depends on OCF_OCF
	help
	  OCF driver for measuring ipsec overheads (does no crypto)

config OCF_BENCH
	tristate "ocf-bench (HW crypto in-kernel benchmark)"
	depends on OCF_OCF
	help
	  A very simple encryption test for the in-kernel interface
	  of OCF.  Also includes code to benchmark the IXP Access library
	  for comparison.

endmenu
```

## trunk/linux-2.6.21.x/drivers/media/video/uvc/Kconfig
```kconfig
config USB_VIDEO_CLASS
      tristate "USB Video Class (UVC)"
      depends on USB
      ---help---
      Support for the USB Video Class (UVC).  Currently only video
      input devices, such as webcams, are supported.
     
      For more information see: <http://linux-uvc.berlios.de/>

config USB_VIDEO_CLASS_DEBUG
	bool "Enable debug mode"
	depends on USB_VIDEO_CLASS
```

## trunk/linux-2.6.21.x/drivers/net/raeth/Kconfig
```kconfig
config RAETH
        tristate "Ralink GMAC"
        ---help---
          This driver supports Ralink gigabit ethernet family of
          adapters.

config RAETH_NAPI
        bool "Use Rx Polling (NAPI)"
        depends on RAETH

choice
	prompt "Network BottomHalves"
        depends on RAETH
	default RA_NETWORK_TASKLET_BH

	config RA_NETWORK_TASKLET_BH
	bool "Tasklet"

	config RA_NETWORK_WORKQUEUE_BH
	bool "Work Queue"

endchoice

#config RAETH_SKB_RECYCLE
#        bool "SKB Recycle(Linux)"
#        depends on RA_NETWORK_WORKQUEUE_BH && RALINK_RT63365

config RAETH_SKB_RECYCLE_2K
        bool "SKB Recycle_2K(Proprietary)"
        depends on !RALINK_RT63365

#config RAETH_SPECIAL_TAG
#        bool "Ralink Special Tag (0x810x)"
#        depends on (RALINK_RT3052 || RALINK_RT3352 || RALINK_RT5350 || RALINK_RT6855 || RALINK_RT63365)

config RAETH_JUMBOFRAME
        bool "Jumbo Frame up to 4K bytes"
        depends on RAETH && !(RALINK_RT3052 || RALINK_RT3352 || RALINK_RT5350)

config RAETH_CHECKSUM_OFFLOAD
        bool "TCP/UDP/IP checksum offload"
	default y
        depends on RAETH && !RALINK_RT2880

#config RAETH_TSO
#        bool "TSO (Tcp Segmentaton Offload)"
#	select RAETH_CHECKSUM_OFFLOAD
#	default n
#	depends on RAETH && (RALINK_RT6855 || RALINK_RT63365)

config RAETH_HW_VLAN_TX
        bool "Transmit VLAN HW"
        depends on RAETH
        ---help---
          Please set net.ipv4.vlan_double_tag=0 for enable vlan hw offload before eth2 up.

#config RAETH_QOS
#        bool "QoS Feature"
#        depends on RAETH && !RALINK_RT2880 && !RAETH_TSO

choice
        prompt "QoS Type"
        depends on RAETH_QOS
        default DSCP_QOS_DSCP

config  RAETH_QOS_DSCP_BASED
        bool "DSCP-based"
        depends on RAETH_QOS 

config  RAETH_QOS_VPRI_BASED
        bool "VPRI-based"
        depends on RAETH_QOS

endchoice

choice
        prompt "GMAC is connected to"
        depends on RAETH
        default GE1_RGMII_FORCE_1000

config  GE1_MII_FORCE_100
        bool "MII_FORCE_100 (10/100M Switch)"
        depends on (RALINK_RT2880 || RALINK_RT3883) 

config  GE1_MII_AN
        bool "MII_AN (100Phy)"
        depends on (RALINK_RT2880 || RALINK_RT3883) 

config  GE1_RVMII_FORCE_100
        bool "RvMII_FORCE_100 (CPU)"
        depends on (RALINK_RT2880 || RALINK_RT3883) 

config  GE1_RGMII_FORCE_1000
        bool "RGMII_FORCE_1000 (GigaSW, CPU)"
        depends on (RALINK_RT2880 || RALINK_RT3883)

config  GE1_RGMII_AN
        bool "RGMII_AN (GigaPhy)"
        depends on (RALINK_RT2880 || RALINK_RT3883) 

config  RT_3052_ESW
        bool "Ralink Embedded Switch"
        depends on RALINK_RT3052 || RALINK_RT3352 || RALINK_RT5350 || RALINK_RT6855 || RALINK_RT63365


endchoice


config	RALINK_VISTA_BASIC
	bool 'Vista Basic Logo for IC+ 175C'
        depends on LAN_WAN_SUPPORT && (RALINK_RT2880 || RALINK_RT3883)

config RAETH_HAS_PORT5
        bool "Port 5 Support"
        depends on RAETH && (RALINK_RT3052 || RALINK_RT3352 || RALINK_RT6855 || RALINK_RT63365)
choice
        prompt "Target Mode"
        depends on RAETH_HAS_PORT5
	default P5_RGMII_TO_MAC_MODE

	config P5_MAC_TO_PHY_MODE
		bool "Giga_Phy (RGMII)"
	config P5_RGMII_TO_MAC_MODE
		bool "Giga_SW/iNIC (RGMII)"
	config P5_MII_TO_MAC_MODE
		bool "External_CPU (MII_RvMII)"
	config P5_RMII_TO_MAC_MODE
		bool "External_CPU (RvMII_MII)"
endchoice

config  MAC_TO_GIGAPHY_MODE_ADDR
        hex "Phy Address"
	default 0x1F
        depends on GE1_MII_AN || GE1_RGMII_AN || P5_MAC_TO_PHY_MODE

config RAETH_GMAC2
        bool "GMAC2 Support"
        depends on RAETH && RALINK_RT3883

choice
        prompt "GMAC2 is connected to"
        depends on RAETH_GMAC2
        default GE2_RGMII_AN

config  GE2_MII_FORCE_100
        bool "MII_FORCE_100 (10/100M Switch)"
        depends on RAETH_GMAC2

config  GE2_MII_AN
        bool "MII_AN (100Phy)"
        depends on RAETH_GMAC2

config  GE2_RVMII_FORCE_100
        bool "RvMII_FORCE_100 (CPU)"
        depends on RAETH_GMAC2

config  GE2_RGMII_FORCE_1000
        bool "RGMII_FORCE_1000 (GigaSW, CPU)"
        depends on RAETH_GMAC2

config  GE2_RGMII_AN
        bool "RGMII_AN (GigaPhy)"
        depends on RAETH_GMAC2

endchoice

config  MAC_TO_GIGAPHY_MODE_ADDR2
        hex "Phy Address"
	default 0x1E
        depends on GE2_MII_AN || GE2_RGMII_AN 

#force 100M
config RAETH_ROUTER
bool
default y if GE1_MII_FORCE_100 || GE2_MII_FORCE_100 || GE1_RVMII_FORCE_100 || GE2_RVMII_FORCE_100

#force 1000M
config MAC_TO_MAC_MODE
bool
default y if GE1_RGMII_FORCE_1000 || GE2_RGMII_FORCE_1000

#AN
config GIGAPHY
bool
default y if GE1_RGMII_AN || GE2_RGMII_AN

#AN
config 100PHY
bool
default y if GE1_MII_AN || GE2_MII_AN

config RAETH_SNMPD
	bool "Support SNMPD in raeth"
	depends on RAETH
	default n

config RAETH_DHCP_TOUCH
	bool "Send SIGUSR1/2 to dhcpc at media state changed."
	depends on RT_3052_ESW
	default n

config RAETH_READ_MAC_FROM_MTD
        bool "Read mac adress from mtdflash at boot time"
        depends on RAETH
	default n

config RAETH_MEMORY_OPTIMIZATION
	bool "Decrease memory usadge. Need for <32Mb RAM devices. More CPU use."
	depends on RAETH
	default n

config RAETH_ACCEPT_OVERSIZED
	bool "Accept all oversized packets."
	depends on RAETH
	default y
```

## trunk/linux-2.6.21.x/drivers/net/wireless/rt2860v2_sta/Kconfig
```kconfig
config RT2860V2_STA
	tristate "Ralink RT2860 802.11n STA support"
	depends on NET_RADIO 

config  RT2860V2_STA_WPA_SUPPLICANT
	bool "WPA Supplicant"
	depends on RT2860V2_STA

config  RT2860V2_STA_ETH_CONVERT
	bool "Ethernet Convert Support"
	depends on RT2860V2_STA

config  RT2860V2_STA_DPB
	bool
	depends on RT2860V2_STA_ETH_CONVERT
	default y

config  RT2860V2_STA_WMM_ACM
	bool "WMM ACM Support"
	depends on RT2860V2_STA

config  RT2860V2_STA_LED
	bool "LED Support"
	depends on RT2860V2_STA

config  RT2860V2_STA_IDS
        bool "IDS (Intrusion Detection System) Support"
        depends on RT2860V2_STA

config  RT2860V2_STA_WSC
	bool "WSC (WiFi Simple Config)"
	depends on RT2860V2_STA

config  RT2860V2_STA_CARRIER
	bool "Carrier Sense Support"
	depends on RT2860V2_STA
	select RALINK_TIMER
	select RALINK_TIMER_DFS

config  RT2860V2_STA_DLS
	bool "DLS ((Direct-Link Setup) Support"
	depends on RT2860V2_STA

config  RT2860V2_RT3XXX_STA_ANTENNA_DIVERSITY
	bool "Antenna Diversity Support"
	depends on RT2860V2_STA

config  RT2860V2_STA_VIDEO_TURBINE
	bool "Video Turbine support"
	depends on RT2860V2_STA

config  RT2860V2_STA_INTELLIGENT_RATE_ADAPTION
	bool "Intelligent Rate Adaption"
	depends on RT2860V2_STA
	depends on RALINK_RT2883 || RALINK_RT3883 

config  RT2860V2_STA_TXBF
	bool "Tx Bean Forming Support (Only 3883)"
	depends on RT2860V2_STA
	depends on RALINK_RT2883 || RALINK_RT3883 

config  RT2860V2_80211N_DRAFT3
        bool "802.11n Draft3"
        depends on RT2860V2_STA

#config  RT2860V2_EXT_CHANNEL_LIST
#        bool "Extension Channel List"
#        depends on RT2860V2_STA

config  RT2860V2_SNMP
	bool "Net-SNMP Support"
	depends on RT2860V2_STA

config RALINK_RT2880_STA_DBG
        bool "Debug support for STA mode"
	default n
	depends on RT2860V2_STA
```

## trunk/linux-2.6.21.x/drivers/usb/dwc_otg/Kconfig
```kconfig
config DWC_OTG
	depends on RALINK_RT3052 || RALINK_RT5350
        tristate "Ralink DWC_OTG support"
        ---help---
          This driver supports Ralink DWC_OTG

choice
        prompt "USB Operation Mode"
        depends on DWC_OTG
        default DWC_OTG_HOST_ONLY

config DWC_OTG_HOST_ONLY
        bool "HOST ONLY MODE"
        depends on DWC_OTG

config DWC_OTG_DEVICE_ONLY
        bool "DEVICE ONLY MODE"
        depends on DWC_OTG

endchoice

config DWC_OTG_FAST_TRANSACTION
        bool "Enable fast transaction for Ralink otg driver."
        depends on DWC_OTG

config DWC_OTG_DEBUG
        bool "Enable debug mode"
        depends on DWC_OTG
```

## trunk/linux-2.6.21.x/net/bridge/Kconfig
```kconfig
#
# 802.1d Ethernet Bridging
#

config BRIDGE
	tristate "802.1d Ethernet Bridging"
	select LLC
	---help---
	  If you say Y here, then your Linux box will be able to act as an
	  Ethernet bridge, which means that the different Ethernet segments it
	  is connected to will appear as one Ethernet to the participants.
	  Several such bridges can work together to create even larger
	  networks of Ethernets using the IEEE 802.1 spanning tree algorithm.
	  As this is a standard, Linux bridges will cooperate properly with
	  other third party bridge products.

	  In order to use the Ethernet bridge, you'll need the bridge
	  configuration tools; see <file:Documentation/networking/bridge.txt>
	  for location. Please read the Bridge mini-HOWTO for more
	  information.

	  If you enable iptables support along with the bridge support then you
	  turn your bridge into a bridging IP firewall.
	  iptables will then see the IP packets being bridged, so you need to
	  take this into account when setting up your firewall rules.
	  Enabling arptables support when bridging will let arptables see
	  bridged ARP traffic in the arptables FORWARD chain.

	  To compile this code as a module, choose M here: the module
	  will be called bridge.

	  If unsure, say N.

config BRIDGE_IGMP_REPORT_NO_FLOODING
	bool "IGMP report packets to CPU only(No flooding)"
	depends on BRIDGE
	default y
	---help---
	  prevent IGMP report packet flooding to all NICs.

config BRIDGE_2WAYS_FDB
	bool "2-Ways Forwarding DataBase"
	depends on BRIDGE
	default y
	---help---
	  prevent ARP flooding attack (memory protection code)

config BRIDGE_FORWARD_CTRL
	bool "Forwarding Control"
	depends on BRIDGE
	default y
	---help---
	  This option allows you to enable/disable the forward function of the kernel
	  bridge module by proc_fs /proc/net/br_forward_br0.
	  The default status is 1, indicates bridge forward enable.

	  To disable the function just echo 0 to this node:
	  echo 0 > /proc/net/br_forward_br0

	  and echo 1 to re-enable it:
	  echo 1 > /proc/net/br_forward_br0

config BRIDGE_MAC_AUTO
        bool "Set mac to bridge automaticaly"
        depends on BRIDGE
	default y
        ---help---

config BRIDGE_FASTPATH
	bool "Bridge offload engine support"
	depends on BRIDGE
	default y
	---help---
	  Fastest bridge operation support. WARNING CONFLICT WITH BR_NETFILTER

config BRIDGE_EAP
	bool "Bridge 802.1x/EAP hacks from openwrt."
	depends on BRIDGE
	default y
	---help---
	  Bridge do not forward 802.1x/EAP frames and always accept eap to local.
```

## trunk/linux-2.6.21.x/ralink/Kconfig
```kconfig
menu "Ralink Module"

###########
# Product ID
###########
config RT_FULL_DEVICE_NAME
        string "Original device name"
        default "Acorp WR-N"


###########
# Debuging
###########
source "drivers/net/rt_rdm/Kconfig"

#############
# Wire
#############
menu "Ethernet Ralink RT3xx/RT28xx wire driver"
source "drivers/net/raeth/Kconfig"
endmenu


#############
# Wireless
#############
menu "Platform config for Ralink RT3xx/RT28xx/RT5xx"
choice
        prompt "RF Type"
        depends on RALINK_RT5350
        default RALINK_RT5350_1T1R

        config  RALINK_RT5350_1T1R
        bool "1T1R"
endchoice

choice
        prompt "RF Type"
        depends on RALINK_RT3052
        default RALINK_RT3052_2T2R

        config  RALINK_RT3050_1T1R
        bool "1T1R"

        config  RALINK_RT3051_1T2R
        bool "1T2R"

        config  RALINK_RT3052_2T2R
        bool "2T2R"
endchoice

choice
        prompt "RF Type"
        depends on  RALINK_RT3352 

        config  RALINK_RT3352_2T2R
        bool "2T2R"
endchoice

choice
	prompt "RF Type"
	depends on RALINK_RT3883

	config  RALINK_RT3662_2T2R
	bool "2T3R (RT3662)"

	config  RALINK_RT3883_3T3R
	bool "3T3R (RT3883)"
endchoice
endmenu


# split driver in one dir
menu "AP MODE Ralink RT3xx/RT28xx wireless driver"
source "drivers/net/wireless/rt2860v2_ap/Kconfig"
endmenu
menu "STA/Client MODE Ralink RT3xx/RT28xx wireless driver"
source "drivers/net/wireless/rt2860v2_sta/Kconfig"
endmenu
menu "AP MODE Ralink PCIe RT309X wireless driver"
source "drivers/net/wireless/rt3090_ap/Kconfig"
endmenu

menu "NAT acell mode"
choice
        prompt "Hardware NAT mode"
config  RA_NAT_HW
        bool "Hardware NAT acceleration"
config RA_NAT_NONE
        bool "Disable NAT acceleration"
endchoice

config BCM_NAT
        tristate "Broadcom fast NAT support"
        depends on NF_CONNTRACK && NF_NAT
        default y
        help
                This helps packets pass through netfilter faster when a packet
                is an established or reply traffic.

if RA_NAT_HW
source "net/nat/hw_nat/Kconfig"
endif
endmenu

menu "Ralink DEVICES"
config RTDEV_USB
bool
default y if RT305x_INIC_USB || RT3572_AP

config RTDEV_MII
bool
default y if RT2880v2_INIC_MII || RT305x_INIC_MII

config RTDEV_PCI
bool
default y if RT2880v2_INIC_PCI || RT3090_AP
endmenu

#######
# USB
#######
config RT3XXX_EHCI_OHCI
	bool "Ralink USB EHCI/OHCI controller support"
        depends on (RALINK_RT3883 || RALINK_RT3352)
	select USB_ARCH_HAS_OHCI
	select USB_ARCH_HAS_EHCI

source "drivers/usb/dwc_otg/Kconfig"

endmenu
```
