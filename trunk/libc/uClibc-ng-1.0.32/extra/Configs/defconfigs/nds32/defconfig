## trunk/linux-3.0.x/drivers/net/rtl8367m/Kconfig
```kconfig
config RTL8367M
       tristate "Realtek RTL8367MB/RB Ethernet PHY Giga-Switch"

choice
	prompt "Select ASIC Type"
	depends on RTL8367M
	default RTL8367M_ASIC_MVB

	config  RTL8367M_ASIC_MVB
	bool "RTL8367M-VB (TQFP176, 5+2 Ports)"
	depends on RTL8367M

	config  RTL8367M_ASIC_RVB
	bool "RTL8367R-VB (LQFP128, 5+1 Ports)"
	depends on RTL8367M

	config  RTL8367M_ASIC_MB
	bool "RTL8367MB (DR-QFN164, 5+2 Ports)"
	depends on RTL8367M

	config  RTL8367M_ASIC_RB
	bool "RTL8367RB (LQFP128, 5+2 Ports)"
	depends on RTL8367M
endchoice

config  RTL8367M_SMI_BUS_CPU_GPIO_DATA
	int "Ralink GPIO Pin for SMI Bus Data (1..51)"
	depends on RTL8367M
	default 1
	help
	please choose Ralink SoC GPIO pin from range 1..51

config  RTL8367M_SMI_BUS_CPU_GPIO_CLCK
	int "Ralink GPIO Pin for SMI Bus Clock (1..51)"
	depends on RTL8367M
	default 2
	help
	please choose Ralink SoC GPIO pin from range 1..51

config  RTL8367M_PORT_WAN
	int "WAN Port ID (0..4)"
	depends on RTL8367M
	default 4
	help
	please choose port ID from range 0..4

config  RTL8367M_PORT_LAN1
	int "LAN1 Port ID (0..4)"
	depends on RTL8367M
	default 3
	help
	please choose port ID from range 0..4

config  RTL8367M_PORT_LAN2
	int "LAN2 Port ID (0..4)"
	depends on RTL8367M
	default 2
	help
	please choose port ID from range 0..4

config  RTL8367M_PORT_LAN3
	int "LAN3 Port ID (0..4)"
	depends on RTL8367M
	default 1
	help
	please choose port ID from range 0..4

config  RTL8367M_PORT_LAN4
	int "LAN4 Port ID (0..4)"
	depends on RTL8367M
	default 0
	help
	please choose port ID from range 0..4

config  RTL8367M_RGMII_DELAY_TX
	int "RGMII-to-GMAC Front Delay TX (0..1)"
	depends on RTL8367M
	default 1
	help
	please choose RGMII TX front delay from range 0..1

config  RTL8367M_RGMII_DELAY_RX
	int "RGMII-to-GMAC Front Delay RX (0..7)"
	depends on RTL8367M
	default 1
	help
	please choose RGMII RX front delay from range 0..7
```

## trunk/linux-3.0.x/drivers/net/wireless/ralink/mt7610_ap/Kconfig
```kconfig
config MT7610_AP
	tristate "MediaTek MT7610E 802.11 AP driver"
	select WIRELESS_EXT
	select WEXT_SPY
	select WEXT_PRIV

config  MT7610_AP_LED
	bool "LED support"
	depends on MT7610_AP
	default y

config  MT7610_AP_LED_SOFT
	bool "Soft LED support"
	depends on MT7610_AP && !MT7610_AP_LED && RALINK_GPIO_LED
	default n

config  MT7610_AP_LED_SOFT_GPIO
	int "Soft LED GPIO pin"
	depends on MT7610_AP && MT7610_AP_LED_SOFT
	default -1

config  MT7610_AP_LLTD
	bool "LLTD (Link Layer Topology Discovery Protocol)"
	depends on MT7610_AP
	default y

config  MT7610_AP_WDS
	bool "WDS"
	depends on MT7610_AP
	default y

config  MT7610_AP_MBSS
	bool "MBSSID"
	depends on MT7610_AP
	default y

config  MT7610_AP_MBSS_NEW_MBSSID_MODE
	bool "New MBSSID mode support"
	depends on MT7610_AP
	depends on MT7610_AP_MBSS
	default n

config  MT7610_AP_APCLI
	bool "AP-Client support"
	depends on MT7610_AP
	default y

config  MT7610_AP_MAC_REPEATER
	bool "MAC Repeater Mode support"
	depends on MT7610_AP
	depends on MT7610_AP_APCLI
	default n

config  MT7610_AP_CON_WPS
	bool "Concurrent WPS support"
	depends on MT7610_AP
	depends on MT7610_AP_APCLI
	depends on RT_WSC_V2
	default n

config  MT7610_AP_DFS
	bool "DFS support"
	depends on MT7610_AP
	default n

config  MT7610_AP_CARRIER
	bool "Carrier Detection support"
	depends on MT7610_AP
	default n

config  MT7610_AP_DLS
	bool "802.11e DLS (Direct-Link Setup) support"
	depends on MT7610_AP
	default n

config  MT7610_AP_IDS
	bool "IDS (Intrusion Detection System) support"
	depends on MT7610_AP
	default n

choice
	prompt "Tx Power Compensation"
	depends on MT7610_AP
	default MT7610_AP_TEMPERATURE_COMPENSATION

	config MT7610_AP_TSSI_COMPENSATION
	bool "TSSI DC Calibration & TSSI compensation"

	config MT7610_AP_TEMPERATURE_COMPENSATION
	bool "Tx Power Temperature Compensation"
endchoice
```
