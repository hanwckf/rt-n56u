## trunk/linux-3.0.x/drivers/net/raeth/Kconfig
```kconfig
config  RAETH
	bool "Ralink GMAC"
	---help---
	  This driver supports Ralink gigabit ethernet family of adapters.

config  RAETH_NAPI
	bool "Use NAPI for IRQ processing (instead of Tasklets)"
	default y
	depends on RAETH

config  RAETH_NAPI_GRO
	bool "Use NAPI Generic Receive Offload (GRO)"
	depends on RAETH_NAPI && RAETH_CHECKSUM_OFFLOAD
	default n

config  RAETH_BQL
	bool "Support Tx Byte Queue Limit (BQL)"
	depends on RAETH && BQL
	default n

config  RAETH_QDMA
	bool "QDMA port P5 for Tx path (HW QoS -> 16 pipes)"
	depends on RAETH && RALINK_MT7621
	default y

config RAETH_QDMATX_QDMARX
	bool "QDMA port P5 for Rx path (instead of PDMA port P0)"
	default n
	depends on RAETH && RAETH_QDMA

config  RAETH_JUMBOFRAME
	bool "Jumbo Frames up to 2K bytes"
	depends on RAETH && (RALINK_RT3352 || RALINK_RT3883 || RALINK_MT7620)

config  RAETH_HW_VLAN_RX
	bool "Receive VLAN HW (DoubleVLAN is not supported)"
	depends on RAETH && (RALINK_MT7621 && !RAETH_QDMATX_QDMARX)
	---help---
	  Please disable HW_VLAN_RX if you need double vlan

config  RAETH_HW_VLAN_TX
	bool "Transmit VLAN HW (DoubleVLAN is not supported)"
	depends on RAETH && !(RALINK_RT5350 || RALINK_MT7628)
	---help---
	  Please set net.ipv4.vlan_double_tag=0 for enable vlan hw offload before eth2 up

config  RAETH_CHECKSUM_OFFLOAD
	bool "TCP/UDP/IP checksum offload"
	default y
	depends on RAETH

config RAETH_SG_DMA_TX
	bool "Transmit scatter-gather (fragmented) packets"
	depends on RAETH_CHECKSUM_OFFLOAD && !(RALINK_RT5350 || RALINK_MT7628)
	default y

config RAETH_TSO
	bool "TSOv4 (TCP Segmentaton Offload)"
	depends on RAETH_SG_DMA_TX && (RALINK_MT7620 || RALINK_MT7621)
	default n

config RAETH_TSOV6
	bool "TSOv6 (TCP Segmentaton Offload for IPv6)"
	depends on RAETH_TSO && IPV6
	default n

choice
	prompt "GMAC is connected to"
	depends on RAETH
	default GE1_RGMII_FORCE_1000

	config  GE1_MII_FORCE_100
		bool "MII_FORCE_100 (External 10/100M Switch)"
		depends on (RALINK_RT3883 || RALINK_MT7621)

	config  GE1_MII_AN
		bool "MII_AN (External 10/100M Phy)"
		depends on (RALINK_RT3883 || RALINK_MT7621)

	config  GE1_RVMII_FORCE_100
		bool "RvMII_FORCE_100 (External CPU)"
		depends on (RALINK_RT3883 || RALINK_MT7621)

	config  GE1_RGMII_FORCE_1000
		bool "RGMII_FORCE_1000 (External GigaSW, CPU)"
		depends on (RALINK_RT3883)

	config  GE1_RGMII_FORCE_1000
		bool "RGMII_FORCE_1000 (GE1 -> MT7530 GigaSW P6)"
		depends on (RALINK_MT7621)
		select MT7530_GSW

	config  GE1_TRGMII_FORCE_1200
		bool "TRGMII_FORCE_1200 (GE1 -> MT7530 GigaSW P6)"
		depends on (RALINK_MT7621)
		select MT7530_GSW

	config  GE1_RGMII_AN
		bool "RGMII_AN (External GigaPhy)"
		depends on (RALINK_RT3883 || RALINK_MT7621)

	config  GE1_RGMII_NONE
		bool "NONE (Not used)"
		depends on (RALINK_RT3883 || RALINK_MT7621)

	config  GE1_MAC_ESW
		bool "Integrated ESW"
		depends on (RALINK_RT3052 || RALINK_RT3352 || RALINK_RT5350 || RALINK_MT7620 || RALINK_MT7628)
		select RAETH_ESW if (RALINK_RT5350 || RALINK_MT7628)
endchoice

config RAETH_HAS_PORT5
	bool "Port 5 Support"
	depends on RAETH && (RALINK_RT3052 || RALINK_RT3352 || RALINK_MT7620)
choice
	prompt "Target Mode"
	depends on RAETH_HAS_PORT5
	default P5_RGMII_TO_MAC_MODE

	config P5_MAC_TO_PHY_MODE
		bool "Giga_Phy (RGMII + AN)"

	config P5_RGMII_TO_MAC_MODE
		bool "Giga_SW/iNIC (RGMII)"

	config P5_RGMII_TO_MT7530_MODE
		bool "MT7530 GigaSW (P5 RGMII -> MT7530 GMAC P6)"
		depends on RALINK_MT7620
		select MT7530_GSW

	config P5_MII_TO_MAC_MODE
		bool "External_CPU (MII_RvMII)"

	config P5_RMII_TO_MAC_MODE
		bool "External_CPU (RvMII_MII)"
endchoice

config  MAC_TO_GIGAPHY_MODE_ADDR
	hex "GE1 Phy Address"
	default 0x1F
	depends on RAETH && (GE1_MII_AN || GE1_RGMII_AN)

config  MAC_TO_GIGAPHY_MODE_ADDR
	hex "Port5 Phy Address"
	default 0x5
	depends on RAETH && (P5_MAC_TO_PHY_MODE)

config RAETH_GMAC2
	bool "GMAC2 Support"
	depends on RAETH && (RALINK_RT3883 || RALINK_MT7621)

choice
	prompt "GMAC2 is connected to"
	depends on RAETH_GMAC2
	default GE2_RGMII_FORCE_1000

	config GE2_MII_FORCE_100
		bool "MII_FORCE_100 (External 10/100M Switch)"

	config GE2_MII_AN
		bool "MII_AN (External 100Phy)"

	config GE2_RVMII_FORCE_100
		bool "RvMII_FORCE_100 (External CPU)"

	config GE2_RGMII_FORCE_1000
		bool "RGMII_FORCE_1000 (External GigaSW, CPU)"

	config GE2_RGMII_AN
		bool "RGMII_AN (External GigaPhy)"

	config GE2_INTERNAL_GMAC_P5
		bool "Internal GigaSW (GE2 -> MT7530 GMAC P5)"
		depends on (RALINK_MT7621)
		select MT7530_GSW

	config GE2_INTERNAL_GPHY_P4
		bool "Internal GigaPHY Port 4 (GE2 -> MT7530 P4 AN)"
		depends on (RALINK_MT7621)
		select MT7530_GSW

	config GE2_INTERNAL_GPHY_P0
		bool "Internal GigaPHY Port 0 (GE2 -> MT7530 P0 AN)"
		depends on (RALINK_MT7621)
		select MT7530_GSW
endchoice

config RAETH_HAS_PORT4
	bool "Port 4 Support"
	depends on RAETH && RALINK_MT7620
choice
	prompt "Target Mode"
	depends on RAETH_HAS_PORT4
	default P4_RGMII_TO_MAC_MODE

	config P4_MAC_TO_PHY_MODE
		bool "Giga_Phy (RGMII + AN)"

	config P4_RGMII_TO_MT7530_GMAC_P5
		bool "MT7530 GigaSW (P4 RGMII -> MT7530 GMAC P5)"
		select MT7530_GSW

	config P4_MAC_TO_MT7530_GPHY_P4
		bool "MT7530 GigaPhy Port4 (P4 RGMII -> MT7530 P4 AN)"
		select MT7530_GSW

	config P4_MAC_TO_MT7530_GPHY_P0
		bool "MT7530 GigaPhy Port0 (P4 RGMII -> MT7530 P0 AN)"
		select MT7530_GSW

	config P4_RGMII_TO_MAC_MODE
		bool "Giga_SW/iNIC (RGMII)"

	config P4_MII_TO_MAC_MODE
		bool "External_CPU (MII_RvMII)"

	config P4_RMII_TO_MAC_MODE
		bool "External_CPU (RvMII_MII)"
endchoice

config  MAC_TO_GIGAPHY_MODE_ADDR2
	hex "GE2 Phy Address"
	default 0x1E
	depends on RAETH && (GE2_MII_AN || GE2_RGMII_AN)

config  MAC_TO_GIGAPHY_MODE_ADDR2
	hex
	default 0x0 if (GE2_INTERNAL_GPHY_P0)
	default 0x4 if (GE2_INTERNAL_GPHY_P4)
	depends on RAETH && (GE2_INTERNAL_GPHY_P0 || GE2_INTERNAL_GPHY_P4)

config  MAC_TO_GIGAPHY_MODE_ADDR2
	hex "Port4 Phy Address"
	default 0x4
	depends on RAETH && (P4_MAC_TO_PHY_MODE)

config  MAC_TO_GIGAPHY_MODE_ADDR2
	hex
	default 0x0 if (P4_MAC_TO_MT7530_GPHY_P0)
	default 0x4 if (P4_MAC_TO_MT7530_GPHY_P4)
	depends on RAETH && (P4_MAC_TO_MT7530_GPHY_P0 || P4_MAC_TO_MT7530_GPHY_P4)

config  RAETH_BOTH_GMAC
	bool
	default y if (RAETH_GMAC2 && !GE1_RGMII_NONE)
	depends on RAETH && RAETH_GMAC2

config  RAETH_SWAP_GDMA
	bool "Swap GDMA1<->GDMA2 ports"
	depends on RAETH && RAETH_GMAC2
	default n

config  RAETH_ESW
	bool "Ralink Embedded Switch"
	depends on RAETH && GE1_MAC_ESW && !MT7530_GSW

config  MT7530_GSW
	bool "MediaTek MT7530 Giga-Switch (On-die for MT7621)"
	depends on RAETH && (RALINK_MT7620 || RALINK_MT7621)

config  RAETH_ESW_ONE_PORT
	bool "Use One Ethernet Port Only (MT7628/MT7688)"
	depends on RAETH && (RALINK_MT7628)

config  RAETH_SPECIAL_TAG
	bool "Ralink ESW Special Tag (0x810x)"
	depends on RAETH && (RAETH_ESW || MT7530_GSW)
	default n

config  RAETH_ESW_CONTROL
	bool "Embedded (or MT7530) Switch Control Module (VLAN/Isolation/Status)"
	depends on RAETH && (RAETH_ESW || MT7530_GSW)
	default y

choice
	prompt "IGMP/MLD snooping support"
	depends on RAETH_ESW_CONTROL
	default RAETH_ESW_IGMP_SNOOP_HW

	config RAETH_ESW_IGMP_SNOOP_OFF
	bool "Disable IGMP/MLD snooping"

	config RAETH_ESW_IGMP_SNOOP_SW
	bool "Software mode IGMP/MLD snooping"
	depends on BRIDGE_IGMP_SNOOPING
	select BRIDGE_IGMP_EVENT_HOOK

	config RAETH_ESW_IGMP_SNOOP_HW
	bool "Hardware mode IGMP/MLD snooping"
	depends on !(RALINK_RT3052 || RALINK_RT3352 || RALINK_RT5350 || RALINK_MT7628)
endchoice

config  RAETH_ESW_PORT_WAN
	int "ESW WAN Port ID (0..5)"
	depends on RAETH_ESW_CONTROL
	default 4
	help
	  please choose port ID from range 0..5

config  RAETH_ESW_PORT_LAN1
	int "ESW LAN1 Port ID (0..5)"
	depends on RAETH_ESW_CONTROL
	default 3
	help
	  please choose port ID from range 0..5

config  RAETH_ESW_PORT_LAN2
	int "ESW LAN2 Port ID (0..5)"
	depends on RAETH_ESW_CONTROL
	default 2
	help
	  please choose port ID from range 0..5

config  RAETH_ESW_PORT_LAN3
	int "ESW LAN3 Port ID (0..5)"
	depends on RAETH_ESW_CONTROL
	default 1
	help
	  please choose port ID from range 0..5

config  RAETH_ESW_PORT_LAN4
	int "ESW LAN4 Port ID (0..5)"
	depends on RAETH_ESW_CONTROL
	default 0
	help
	  please choose port ID from range 0..5

config  RAETH_ESW_PORT_LAN5
	int "ESW LAN5 Port ID (0..5), -1 is disabled"
	depends on RAETH_ESW_CONTROL && (GE2_RGMII_AN || P5_MAC_TO_PHY_MODE)
	default -1
	help
	  please choose port ID from range 0..5

config  RAETH_DHCP_TOUCH
	bool "Send SIGUSR1/2 to udhcpc at media state changed"
	depends on RAETH && (RAETH_ESW || MT7530_GSW) && !RAETH_ESW_CONTROL
	default n

config  RAETH_SNMPD
	bool "Support SNMPD counters in raeth"
	depends on RAETH && (RAETH_ESW || MT7530_GSW)
	default n

config  RAETH_READ_MAC_FROM_MTD
	bool "Read MAC address from MTD flash at boot time"
	depends on RAETH
	default y

config  RAETH_MEMORY_OPTIMIZATION
	bool "Decrease memory usage (shrink ring size). Need for < 64Mb RAM devices"
	depends on RAETH
	default n

config  RAETH_DEBUG
	bool "Include additional debug messages and ring dump feature"
	depends on RAETH
	default n

#force 100M (obsolete, used only in wireless driver)
config RAETH_ROUTER
bool
default y if (GE1_MII_FORCE_100 || GE2_MII_FORCE_100 || GE1_RVMII_FORCE_100 || GE2_RVMII_FORCE_100)
depends on RAETH

#force 1000M (obsolete, used only in wireless driver)
config MAC_TO_MAC_MODE
bool
default y if (GE1_RGMII_FORCE_1000 || GE2_RGMII_FORCE_1000)
depends on RAETH && (RALINK_RT3883)
```

## trunk/linux-3.0.x/drivers/net/rtl8367/Kconfig
```kconfig
config RTL8367
	tristate "Realtek RTL8367 Ethernet PHY Giga-Switch"

config RTL8367_API_8370
	bool
	depends on RTL8367

config RTL8367_API_8367B
	bool
	depends on RTL8367

choice
	prompt "Select ASIC Type"
	depends on RTL8367
	default RTL8367_ASIC_M

	config  RTL8367_ASIC_R
	bool "RTL8367R (LQFP128, 5+1 Ports, old ASIC)"
	depends on RTL8367
	select RTL8367_API_8370

	config  RTL8367_ASIC_M
	bool "RTL8367M (TQFP176, 5+2 Ports, old ASIC)"
	depends on RTL8367
	select RTL8367_API_8370

	config  RTL8370_ASIC_M
	bool "RTL8370M (TQFP176, 8+2 Ports, old ASIC)"
	depends on RTL8367
	select RTL8367_API_8370

	config  RTL8367_ASIC_RB
	bool "RTL8367RB (LQFP128, 5+2 Ports)"
	depends on RTL8367
	select RTL8367_API_8367B

	config  RTL8367_ASIC_RVB
	bool "RTL8367R-VB (LQFP128, 5+1 Ports, pin-to-pin with RTL8367R)"
	depends on RTL8367
	select RTL8367_API_8367B

	config  RTL8367_ASIC_MB
	bool "RTL8367MB (DR-QFN164, 5+2 Ports)"
	depends on RTL8367
	select RTL8367_API_8367B

	config  RTL8367_ASIC_MVB
	bool "RTL8367M-VB (TQFP176, 5+2 Ports, pin-to-pin with RTL8367M)"
	depends on RTL8367
	select RTL8367_API_8367B

	config  RTL8365_ASIC_MB
	bool "RTL8365MB (LQFP128, 4+1 Ports)"
	depends on RTL8367
	select RTL8367_API_8367B

	config  RTL8368_ASIC_MB
	bool "RTL8368MB (TQFP176, 5+3 Ports)"
	depends on RTL8367
	select RTL8367_API_8367B
endchoice

choice
	prompt "Select Control Interface"
	depends on RTL8367
	default RTL8367_CIF_SMI

	config  RTL8367_CIF_SMI
	bool "SMI Bus (emulation via GPIO)"
	depends on RTL8367
	select RALINK_GPIO

	config  RTL8367_CIF_MDIO
	bool "MDIO Bus"
	depends on RTL8367
endchoice

config  RTL8367_SMI_BUS_CPU_GPIO_DATA
	int "Ralink GPIO Pin for SMI Bus Data"
	depends on RTL8367 && RTL8367_CIF_SMI
	default 1
	help
	please choose Ralink SoC GPIO pin

config  RTL8367_SMI_BUS_CPU_GPIO_CLCK
	int "Ralink GPIO Pin for SMI Bus Clock"
	depends on RTL8367 && RTL8367_CIF_SMI
	default 2
	help
	please choose Ralink SoC GPIO pin

config  RTL8367_PORT_WAN
	int "WAN Port ID (0..4)"
	depends on RTL8367
	default 4
	help
	please choose port ID from range 0..4

config  RTL8367_PORT_LAN1
	int "LAN1 Port ID (0..4)"
	depends on RTL8367
	default 3
	help
	please choose port ID from range 0..4

config  RTL8367_PORT_LAN2
	int "LAN2 Port ID (0..4)"
	depends on RTL8367
	default 2
	help
	please choose port ID from range 0..4

config  RTL8367_PORT_LAN3
	int "LAN3 Port ID (0..4)"
	depends on RTL8367
	default 1
	help
	please choose port ID from range 0..4

config  RTL8367_PORT_LAN4
	int "LAN4 Port ID (0..4)"
	depends on RTL8367
	default 0
	help
	please choose port ID from range 0..4

config  RTL8367_PORT_LAN5
	int "LAN5 Port ID (0..7)"
	depends on RTL8367 && RTL8370_ASIC_M
	default 5
	help
	please choose port ID from range 0..7

config  RTL8367_PORT_LAN6
	int "LAN6 Port ID (0..7)"
	depends on RTL8367 && RTL8370_ASIC_M
	default 6
	help
	please choose port ID from range 0..7

config  RTL8367_PORT_LAN7
	int "LAN7 Port ID (0..7)"
	depends on RTL8367 && RTL8370_ASIC_M
	default 7
	help
	please choose port ID from range 0..7

choice
	prompt "Select Ext CPU Port for handle LAN Ports"
	depends on RTL8367
	default RTL8367_LAN_CPU_EXT1

	config  RTL8367_LAN_CPU_EXT0
	bool "Ext0"
	depends on RTL8367 && !RTL8367_ASIC_RB && !RTL8367_ASIC_RVB && !RTL8367_ASIC_R

	config  RTL8367_LAN_CPU_EXT1
	bool "Ext1"
	depends on RTL8367

	config  RTL8367_LAN_CPU_EXT2
	bool "Ext2"
	depends on RTL8367_ASIC_RB
endchoice

config  RTL8367_USE_INIC_EXT
	bool "Use Second Ext Port for Ralink iNIC mii adapter"
	depends on RTL8367 && !RTL8367_ASIC_RVB && !RTL8367_ASIC_R
	default n
	help
	please enabled this to use connected Ralink iNIC WiFi Module to Second Ext Port

config  RTL8367_RGMII_DELAY_TX
	int "RGMII-to-GMAC Front Delay TX (0..1)"
	depends on RTL8367
	default 1
	help
	please choose RGMII TX front delay from range 0..1

config  RTL8367_RGMII_DELAY_RX
	int "RGMII-to-GMAC Front Delay RX (0..7)"
	depends on RTL8367
	default 1
	help
	please choose RGMII RX front delay from range 0..7

config  RTL8367_IGMP_SNOOPING
	bool "Enable IGMP Snooping Feature"
	depends on RTL8367 && BRIDGE_IGMP_SNOOPING
	select BRIDGE_IGMP_EVENT_HOOK
	default y

comment "MT7621 GSW port control"
	depends on RTL8367 && RAETH && (RALINK_MT7621)

config  RTL8367_MCM_WAN_PORT
	bool "MT7621 GSW: use one Ethernet port as WAN"
	depends on RTL8367 && RAETH && (RALINK_MT7621)
	select MT7530_GSW

config  RTL8367_MCM_WAN_PORT_ID
	int "MT7621 GSW: WAN Port ID (0..4)"
	depends on RTL8367_MCM_WAN_PORT
	default 4
	help
	  please choose port ID from range 0..4
```
