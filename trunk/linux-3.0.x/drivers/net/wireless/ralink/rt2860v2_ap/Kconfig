## trunk/linux-3.0.x/drivers/net/wireless/ralink/rt2860v2_ap/Kconfig
```kconfig
config RT2860V2_AP
	tristate "Ralink APSoC 802.11 AP driver"
	select WIRELESS_EXT
	select WEXT_SPY
	select WEXT_PRIV

config  RT2860V2_AP_LED
	bool "LED support"
	depends on RT2860V2_AP

config  RT2860V2_AP_LED_SOFT
	bool "Soft LED support"
	depends on RT2860V2_AP && !RT2860V2_AP_LED && RALINK_GPIO_LED
	default n

config  RT2860V2_AP_LED_SOFT_GPIO
	int "Soft LED GPIO pin"
	depends on RT2860V2_AP && RT2860V2_AP_LED_SOFT
	default -1

config  RT2860V2_AP_LLTD
	bool "LLTD (Link Layer Topology Discovery Protocol)"
	depends on RT2860V2_AP

config  RT2860V2_AP_WDS
	bool "WDS support"
	depends on RT2860V2_AP

config  RT2860V2_AP_MBSS
	bool "MBSSID support"
	depends on RT2860V2_AP

config  RT2860V2_AP_MBSS_NEW_MBSSID_MODE
	bool "New MBSSID mode"
	default n
	depends on RT2860V2_AP_MBSS
	depends on RALINK_RT3883 || RALINK_RT3352 || RALINK_RT5350 || RALINK_MT7620

config  RT2860V2_AP_APCLI
	bool "AP-Client support"
	depends on RT2860V2_AP

config  RT2860V2_AP_MAC_REPEATER
	bool "MAC Repeater support"
	depends on RT2860V2_AP_APCLI
	depends on RALINK_MT7620
	default n

config  RT2860V2_AP_DFS
	bool "DFS support"
	depends on RT2860V2_AP
	depends on RALINK_RT3883
	select RALINK_TIMER_DFS
	help
	  Support dynamic frequency selection

config  RT2860V2_AP_CARRIER
	bool "Carrier Detection support"
	depends on RT2860V2_AP
	select RALINK_TIMER_DFS
	help
	  Carrier Sense Multi-Access/Collision Detection.

config  RT2860V2_AP_DLS
	bool "DLS (Direct-Link Setup) support"
	depends on RT2860V2_AP

config  RT2860V2_AP_IDS
	bool "IDS (Intrusion Detection System) support"
	depends on RT2860V2_AP

config  RT2860V2_AP_ANTENNA_DIVERSITY
	bool "Antenna Diversity support"
	depends on RT2860V2_AP
	depends on RALINK_RT5350

config  RT2860V2_AP_GREENAP
	bool "Green AP mode support"
	depends on RT2860V2_AP

config  RT2860V2_AP_TXBF
	bool "Tx Beam Forming support (Only 3883)"
	depends on RT2860V2_AP
	depends on RALINK_RT3883

choice
	prompt "Choose Power Design"
	depends on RT2860V2_AP
	depends on RALINK_MT7620
	default INTERNAL_PA_INTERNAL_LNA
config  INTERNAL_PA_INTERNAL_LNA
	bool "Internal PA and Internal LNA"
config  INTERNAL_PA_EXTERNAL_LNA
	bool "Internal PA and External LNA"
config  EXTERNAL_PA_EXTERNAL_LNA
	bool "External PA and External LNA"
endchoice

config  RT2860V2_AP_RTMP_INTERNAL_TX_ALC
	bool "TSSI Compensation (Internal TX ALC)"
	depends on RT2860V2_AP
	depends on RALINK_RT3350 || RALINK_RT3352 || RALINK_RT5350 || RALINK_MT7620
	depends on !EXTERNAL_PA_EXTERNAL_LNA
	default n

config  RT2860V2_AP_RTMP_TEMPERATURE_COMPENSATION
	bool "Temperature Compensation (External TX ALC)"
	depends on RT2860V2_AP
	depends on RALINK_MT7620
	default n

config  RT2860V2_AP_ADJ_PWR_CONSUMPTION
	bool "Reduce Power Consumption"
	depends on RT2860V2_AP
	depends on RALINK_MT7620
	default n
```

## trunk/linux-3.0.x/drivers/net/wireless/ralink/rt3090_ap/Kconfig
```kconfig
config RT3090_AP
	tristate "Ralink RT309X 802.11 AP driver"
	select WIRELESS_EXT
	select WEXT_SPY
	select WEXT_PRIV

config  RT3090_AP_RT3390
	bool "RT3390 Support"
	default n
	depends on RT3090_AP

config  RT3090_AP_LED
	bool "LED support"
	depends on RT3090_AP

config  RT3090_AP_LLTD
	bool "LLTD (Link Layer Topology Discovery Protocol)"
	depends on RT3090_AP

config  RT3090_AP_WDS
	bool "WDS support"
	depends on RT3090_AP

config  RT3090_AP_MBSS
	bool "MBSSID support"
	depends on RT3090_AP

config  RT3090_AP_APCLI
	bool "AP-Client support"
	depends on RT3090_AP

config  RT3090_AP_DLS
	bool "DLS (Direct-Link Setup) support"
	depends on RT3090_AP

config  RT3090_AP_IDS
	bool "IDS (Intrusion Detection System) support"
	depends on RT3090_AP

config  RT3090_AP_GREENAP
	bool "Green AP mode support"
	depends on RT3090_AP
```

## trunk/linux-3.0.x/drivers/net/wireless/ralink/rt3352_mii/Kconfig
```kconfig
config RT3352_INIC_MII
	tristate "Ralink RT3352 802.11n iNIC MII support"

config  RT3352_INIC_AP
	bool "AP Mode"
	depends on RT3352_INIC_MII
```

## trunk/linux-3.0.x/drivers/net/wireless/ralink/rt3593_ap/Kconfig
```kconfig
config RT3593_AP
	tristate "Ralink RT3593 802.11 AP driver"
	select WIRELESS_EXT
	select WEXT_SPY
	select WEXT_PRIV

config  RT3593_AP_LED
	bool "LED support"
	depends on RT3593_AP

config  RT3593_AP_LLTD
	bool "LLTD (Link Layer Topology Discovery Protocol)"
	depends on RT3593_AP

config  RT3593_AP_WDS
	bool "WDS support"
	depends on RT3593_AP

config  RT3593_AP_MBSS
	bool "MBSSID support"
	depends on RT3593_AP

config  RT3593_AP_MBSS_NEW_MBSSID_MODE
	bool "New MBSSID mode support"
	default n
	depends on RT3593_AP_MBSS

config  RT3593_AP_APCLI
	bool "AP-Client support"
	depends on RT3593_AP

config  RT3593_AP_DFS
	bool "DFS support"
	depends on RT3593_AP

config  RT3593_AP_CARRIER
	bool "Carrier Detection support"
	depends on RT3593_AP

#config  RT3593_AP_EXT_CHANNEL_LIST
#	bool "Extension Channel List"
#	depends on RT3593_AP

config  RT3593_AP_HIGH_POWER
	bool "High Power support"
	depends on RT3593_AP

config  RT3593_AP_TXBF_SUPPORT
	bool "TX Beam Forming support"
	depends on RT3593_AP

config  RT3593_AP_DLS
	bool "DLS (Direct-Link Setup) support"
	depends on RT3593_AP

config  RT3593_AP_IDS
	bool "IDS (Intrusion Detection System) support"
	depends on RT3593_AP

config  RT3593_AP_GREENAP
	bool "Green AP mode support"
	depends on RT3593_AP
```

## trunk/linux-3.0.x/drivers/net/wireless/ralink/rt5592_ap/Kconfig
```kconfig
config RT5592_AP
	tristate "Ralink RT5592 802.11 AP driver"
	select WIRELESS_EXT
	select WEXT_SPY
	select WEXT_PRIV

config  RT5592_AP_LED
	bool "LED support"
	depends on RT5592_AP

config  RT5592_AP_LED_SOFT
	bool "Soft LED support"
	depends on RT5592_AP && !RT5592_AP_LED && RALINK_GPIO_LED
	default n

config  RT5592_AP_LED_SOFT_GPIO
	int "Soft LED GPIO pin"
	depends on RT5592_AP && RT5592_AP_LED_SOFT
	default -1

config  RT5592_AP_LLTD
	bool "LLTD (Link Layer Topology Discovery Protocol)"
	depends on RT5592_AP

config  RT5592_AP_WDS
	bool "WDS support"
	depends on RT5592_AP

config  RT5592_AP_MBSS
	bool "MBSSID support"
	depends on RT5592_AP

config  RT5592_AP_MBSS_NEW_MBSSID_MODE
	bool "New MBSSID mode support"
	default n
	depends on RT5592_AP_MBSS

config  RT5592_AP_APCLI
	bool "AP-Client support"
	depends on RT5592_AP

config  RT5592_AP_DFS
	bool "DFS support"
	depends on RT5592_AP

config  RT5592_AP_CARRIER
	bool "Carrier Detection support"
	depends on RT5592_AP

#config  RT5592_AP_EXT_CHANNEL_LIST
#	bool "Extension Channel List"
#	depends on RT5592_AP

config  RT5592_AP_DLS
	bool "DLS (Direct-Link Setup) Support"
	depends on RT5592_AP

config  RT5592_AP_IDS
	bool "IDS (Intrusion Detection System) Support"
	depends on RT5592_AP

config  RT5592_AP_GREENAP
	bool "Green AP mode support"
	depends on RT5592_AP

config  RT5592_AP_EP_SUPPORT
	bool "RT5592 External PA support"
	default n
	depends on RT5592_AP
```

## trunk/linux-3.0.x/drivers/net/wireless/rt3090_ap/Kconfig
```kconfig
config RT3090_AP
	tristate "Ralink RT309X/RT339X/RT539X/RT5592/RT359X 802.11n AP support"
	select WIRELESS_EXT
	select WEXT_SPY
	select WEXT_PRIV

config  RT3090_AP_LED
	bool "LED Support"
	depends on RT3090_AP

config  RT3090_AP_WSC
	bool "WSC (WiFi Simple Config)"
	depends on RT3090_AP

config  RT3090_AP_WSC_V2
	bool "WSC V2 (WiFi Simple Config Version 2)"
	default n
	depends on RT3090_AP_WSC

config  RT3090_AP_LLTD
	bool "LLTD (Link Layer Topology Discovery Protocol)"
	depends on RT3090_AP

config  RT3090_AP_WDS
	bool "WDS"
	depends on RT3090_AP

config  RT3090_AP_MBSS
	bool "MBSSID"
	depends on RT3090_AP

#config  RT3090_AP_MBSS_NEW_MBSSID_MODE
#	bool "New MBSSID mode support"
#	default n
#	depends on RT5392_AP_MBSS || RT5592_AP_MBSS || RT3593_AP_MBSS

config  RT3090_AP_APCLI
	bool "AP-CLient Support"
	depends on RT3090_AP

config  RT3090_AP_IGMP_SNOOP
	bool "IGMP snooping"
	depends on RT3090_AP

config  RT3090_AP_NETIF_BLOCK
	bool "NETIF Block"
	depends on RT3090_AP
	help
	Support Net interface block while Tx-Sw queue full

#config  RT3090_AP_DFS
#	bool "DFS support"
#	depends on RT5592_AP || RT3593_AP
#	select RALINK_TIMER_DFS

#config  RT3090_AP_CARRIER
#	bool "Carrier Detection support"
#	depends on  RT5592_AP || RT3593_AP
#	select RALINK_TIMER_DFS

#config  RT3090_AP_EXT_CHANNEL_LIST
#	bool "Extension Channel List"
#	depends on  RT5592_AP || RT3593_AP

#config  RT3090_AP_HIGH_POWER
#	bool "High Power Support"
#	depends on RT3593_AP

config  RT3090_AP_VIDEO_TURBINE
	bool "Video Turbine support"
	depends on RT3090_AP

#config  RT3090_AP_TXBF_SUPPORT
#	bool "TX Beam Forming support"
#	depends on RT3593_AP

config  RT3090_AP_DLS
	bool "DLS (Direct-Link Setup) Support"
	depends on RT3090_AP

#config  RT3090_AP_IDS
#	bool "IDS (Intrusion Detection System) Support"
#	depends on RT3090_AP

config  RT3090_AP_GREENAP
	bool "Green AP mode support"
	depends on RT3090_AP

config  RT3090_AP_AUTO_CH_SELECT_ENHANCE
	bool "Auto Channel Selection Enhancement"
	default y
	depends on RT3090_AP

config  RT3090_AP_80211N_DRAFT3
	bool "802.11n Draft3"
	depends on RT3090_AP

config  RT3090_AP_MCAST_RATE_SPECIFIC
	bool "User specific TX rate of mcast packets"
	default y
	depends on RT3090_AP

config  RT3090_AP_READ_MAC_FROM_MTD
	bool "Read and set MAC from MTD/EEPROM"
	default y
	depends on RT3090_AP

#config  RT3090_AP_BRIDGE_FASTPATH
#	bool "Bridge wlan2lan operation offload"
#	depends on RT3090_AP

#config  RT3090_AP_MC_SUPPORT
#	bool "Multiple Card Support"
#	depends on RT3090_AP

config  RT3090_AP_ATE
	bool "Provide ATE testmode commands support"
	default n
	depends on RT3090_AP

config  RT3090_AP_QA
	bool "QA tool support"
	default n
	depends on RT3090_AP_ATE

config  RT3090_AP_DBG
	bool "Debug support for AP mode"
	default n
	depends on RT3090_AP
```

## trunk/linux-3.0.x/drivers/net/wireless/rt309x/2.4.X.X/rt3090_ap/Kconfig
```kconfig
config RT3090_AP
	tristate "Ralink RT309X 802.11n AP support"
	select WIRELESS_EXT
	select WEXT_SPY
	select WEXT_PRIV

config  RT3090_AP_LED
	bool "LED Support"
	depends on RT3090_AP

config  RT3090_AP_WSC
	bool "WSC (WiFi Simple Config)"
	depends on RT3090_AP

config  RT3090_AP_LLTD
	bool "LLTD (Link Layer Topology Discovery Protocol)"
	depends on RT3090_AP

config  RT3090_AP_WDS
	bool "WDS"
	depends on RT3090_AP

config  RT3090_AP_WMM_ACM
	bool "WMM ACM"
	depends on RT3090_AP

config  RT3090_AP_MBSS
	bool "MBSSID"
	depends on RT3090_AP

config  RT3090_AP_APCLI
	bool "AP-CLient Support"
	depends on RT3090_AP

config  RT3090_AP_IGMP_SNOOP
	bool "IGMP snooping"
	depends on RT3090_AP

config  RT3090_AP_NETIF_BLOCK
	bool "NETIF Block"
	depends on RT3090_AP
	help
	Support Net interface block while Tx-Sw queue full

config  RT3090_AP_DLS
	bool "DLS (Direct-Link Setup) Support"
	depends on RT3090_AP

#config  RT3090_AP_IDS
#	bool "IDS (Intrusion Detection System) Support"
#	depends on RT3090_AP

config  RT3090_AP_GREENAP
	bool "Green AP mode support"
	depends on RT3090_AP

config  RT3090_AP_AUTO_CH_SELECT_ENHANCE
	bool "Auto Channel Selection Enhancement"
	default y
	depends on RT3090_AP

config  RT3090_AP_80211N_DRAFT3
	bool "802.11n Draft3"
	depends on RT3090_AP

config  RT3090_AP_MCAST_RATE_SPECIFIC
	bool "User specific TX rate of mcast packets"
	default y
	depends on RT3090_AP

config  RT3090_AP_READ_MAC_FROM_MTD
	bool "Read and set MAC from MTD/EEPROM"
	default y
	depends on RT3090_AP

#config  RT3090_AP_BRIDGE_FASTPATH
#	bool "Bridge wlan2lan operation offload"
#	depends on RT3090_AP

config  RT3090_AP_ATE
	bool "Provide ATE+QA testmode commands support"
	default n
	depends on RT3090_AP

config  RT3090_AP_DBG
	bool "Debug support for AP mode"
	default n
	depends on RT3090_AP
```

## trunk/linux-3.0.x/drivers/net/wireless/rt3883/2.4.X.X/rt2860v2_ap/Kconfig
```kconfig
config RT2860V2_AP
	tristate "Ralink RT3883/RT3662 802.11n AP support"
	select WIRELESS_EXT
	select WEXT_SPY
	select WEXT_PRIV

config  RT2860V2_AP_LED
	bool "LED Support"
	depends on RT2860V2_AP

config  RT2860V2_AP_WSC
	bool "WSC (WiFi Simple Config)"
	depends on RT2860V2_AP

config  RT2860V2_AP_WIN7PREVIEW
	bool "Win7 Logo Preview"
	default n
	depends on RT2860V2_AP_WSC

config  RT2860V2_AP_LLTD
	bool "LLTD (Link Layer Topology Discovery Protocol)"
	depends on RT2860V2_AP

config  RT2860V2_AP_WDS
	bool "WDS"
	depends on RT2860V2_AP

config  RT2860V2_AP_WMM_ACM
	bool "WMM ACM"
	depends on RT2860V2_AP
	default n

config  RT2860V2_AP_MBSS
	bool "MBSSID"
	depends on RT2860V2_AP

config  RT2860V2_AP_MBSS_NEW_MBSSID_MODE
	bool "New MBSSID mode"
	default n
	depends on RT2860V2_AP_MBSS
	depends on RALINK_RT3883 || RALINK_RT3352

config  RT2860V2_AP_APCLI
	bool "AP-CLient Support"
	depends on RT2860V2_AP

config  RT2860V2_AP_IGMP_SNOOP
	bool "IGMP snooping"
	depends on RT2860V2_AP

config  RT2860V2_AP_NETIF_BLOCK
	bool "NETIF Block"
	depends on RT2860V2_AP
	help
	Support Net interface block while Tx-Sw queue full

config  RT2860V2_AP_DFS
	bool "DFS"
	depends on RT2860V2_AP
	select RALINK_TIMER_DFS
	help
	Support dynamic freqrency selection

config  RT2860V2_AP_CARRIER
	bool "Carrier Detect"
	depends on RT2860V2_AP
	select RALINK_TIMER_DFS
	help
	Carrier Sense Multi-Access/Collision Detection.

#config  RT2860V2_AP_EXT_CHANNEL_LIST
#	bool "Extension Channel List"
#	depends on RT2860V2_AP

config  RT2860V2_AP_DLS
	bool "DLS ((Direct-Link Setup) Support"
	depends on RT2860V2_AP

config  RT2860V2_AP_IDS
	bool "IDS (Intrusion Detection System) Support"
	depends on RT2860V2_AP

config  RT2860V2_AP_ANTENNA_DIVERSITY
	bool "Antenna Diversity Support"
	depends on RT2860V2_AP

config  RT2860V2_AP_GREENAP
	bool "Green AP mode support"
	depends on RT2860V2_AP

config  RT2860V2_AP_MEMORY_OPTIMIZATION
	bool "Memory Optimization"
	default n
	depends on RT2860V2_AP

config  RT2860V2_AP_VIDEO_TURBINE
	bool "Video Turbine support"
	depends on RT2860V2_AP

config  RT2860V2_AP_TXBF
	bool "Tx Beam Forming Support (Only 3883)"
	depends on RT2860V2_AP
	depends on RALINK_RT2883 || RALINK_RT3883

config  RT2860V2_AP_AUTO_CH_SELECT_ENHANCE
	bool "Auto Channel Selection Enhancement"
	default y
	depends on RT2860V2_AP

config  RT2860V2_AP_80211N_DRAFT3
	bool "802.11n Draft3"
	depends on RT2860V2_AP

#config  RT2860V2_AP_SINGLE_SKU
#	bool "Single SKU"
#	depends on RT2860V2_AP

config  RT2860V2_AP_MCAST_RATE_SPECIFIC
	bool "User specific TX rate of mcast packets"
	default y
	depends on RT2860V2_AP

config  RT2860V2_AP_SNMP
	bool "Net-SNMP Support"
	depends on RT2860V2_AP

config  RT2860V2_AP_READ_MAC_FROM_MTD
	bool "Read and set MAC from MTD/EEPROM"
	default y
	depends on RT2860V2_AP

#config  RT2860V2_AP_BRIDGE_FASTPATH
#	bool "Bridge wlan2lan operation offload"
#	depends on RT2860V2_AP

config  RT2860V2_AP_ATE
	bool "Provide ATE+QA testmode commands support"
	default n
	depends on RT2860V2_AP

config  RT2860V2_AP_DBG
	bool "Debug support for AP mode"
	default n
	depends on RT2860V2_AP
```

## trunk/linux-3.0.x/fs/exfat/Kconfig
```kconfig
config EXFAT_FS
	tristate "exFAT fs support (GPL code from Samsung)"
	select NLS
	help
	  To compile this file system support as a module, choose M here: the
	  module will be called exfat.

	  If unsure, say Y.

config EXFAT_DEFAULT_CODEPAGE
	int "Default codepage for exFAT"
	depends on EXFAT_FS
	default 437
	help
	  This option should be set to the codepage of your exFAT filesystems.

config EXFAT_DEFAULT_IOCHARSET
	string "Default iocharset for exFAT"
	depends on EXFAT_FS
	default "utf8"
	help
	  Set this to the default input/output character set you'd like exFAT to use.
```
