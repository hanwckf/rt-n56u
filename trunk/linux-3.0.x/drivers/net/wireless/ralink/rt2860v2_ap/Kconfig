## trunk/linux-3.4.x/drivers/net/wireless/mt76x2_ap/Kconfig
```kconfig
config MT76X2_AP
	tristate "MediaTek MT7602E/7612E 802.11n/ac AP Support"
	select WIRELESS_EXT
	select WEXT_SPY
	select WEXT_PRIV

config  MT76X2_AP_LED
	bool "LED Support"
	depends on MT76X2_AP
	default y

config  MT76X2_AP_WSC
	bool "WSC (WiFi Simple Config)"
	depends on MT76X2_AP

config  MT76X2_AP_WSC_V2
	bool "WSC V2 (WiFi Simple Config Version 2)"
	depends on MT76X2_AP_WSC
	default n

config  MT76X2_AP_WSC_NFC_SUPPORT
	bool "WSC out-of-band (NFC)"
	depends on MT76X2_AP_WSC
	default n

config  MT76X2_AP_LLTD
	bool "LLTD (Link Layer Topology Discovery Protocol)"
	depends on MT76X2_AP

config  MT76X2_AP_WDS
	bool "WDS"
	depends on MT76X2_AP
	default y

config  MT76X2_AP_MBSS
	bool "MBSSID"
	depends on MT76X2_AP
	default y

config  MT76X2_AP_MBSS_NEW_MBSSID_MODE
	bool "New MBSSID mode support"
	depends on MT76X2_AP
	depends on MT76X2_AP_MBSS
	default n

config  MT76X2_AP_APCLI
	bool "AP-Client Support"
	depends on MT76X2_AP
	default y

config  MT76X2_AP_APCLI_CERT
	bool "AP-Client TGn Cert Support"
	depends on MT76X2_AP
	depends on MT76X2_AP_APCLI
	default n

config  MT76X2_AP_MAC_REPEATER
	bool "MAC Repeater Mode Support"
	depends on MT76X2_AP
	depends on MT76X2_AP_APCLI
	default n

config  MT76X2_AP_IGMP_SNOOP
	bool "IGMP snooping"
	depends on MT76X2_AP
	default y

config  MT76X2_AP_NETIF_BLOCK
	bool "NETIF Block"
	depends on MT76X2_AP
	default n
	help
	  Support Net interface block while Tx-Sw queue full

config  MT76X2_AP_DFS
	bool "DFS support"
	depends on MT76X2_AP
	default n

config  MT76X2_AP_CARRIER
	bool "Carrier Detection support"
	depends on MT76X2_AP
	default n

config  MT76X2_AP_ED_MONITOR
	bool "ED CCA Monitor Support"
	depends on MT76X2_AP
	default n

#config  MT76X2_AP_EXT_CHANNEL_LIST
#	bool "Extension Channel List"
#	depends on MT76X2_AP

#config  MT76X2_AP_VIDEO_TURBINE
#	bool "Video Turbine support"
#	depends on MT76X2_AP
#	default n

config  MT76X2_AP_GREENAP
	bool "Green AP mode support"
	depends on MT76X2_AP

config  MT76X2_AP_DLS
	bool "802.11e DLS (Direct-Link Setup) Support"
	depends on MT76X2_AP
	default n

config  MT76X2_AP_IDS
	bool "IDS (Intrusion Detection System) Support"
	depends on MT76X2_AP
	default n

config  MT76X2_AP_80211N_DRAFT3
	bool "802.11n Draft3"
	depends on MT76X2_AP
	default n

config  MT76X2_AP_80211AC_VHT
	bool "802.11ac Support"
	depends on MT76X2_AP
	default n

config  MT76X2_AP_TXBF_SUPPORT
	bool "Tx Beam Forming Support"
	depends on MT76X2_AP
	default n

config  MT76X2_AP_80211W_PMF
	bool "802.11w Protected Management Frames (PMF) Support"
	depends on MT76X2_AP
	default n

config  MT76X2_AP_MCAST_RATE_SPECIFIC
	bool "User specific TX rate of mcast packets"
	depends on MT76X2_AP
	default y

#config  MT76X2_AP_AUTO_CH_SELECT_ENHANCE
#	bool "Auto Channel Selection Enhancement"
#	depends on MT76X2_AP
#	default y

#config  MT76X2_AP_HDR_TRANS
#	bool "Header Translation Rx Support"
#	depends on MT76X2_AP

#config  MT76X2_AP_CSO
#	bool "CSO/TSO Support"
#	depends on MT76X2_AP

config  MT76X2_AP_DELAYED_TCP_ACK
	bool "Delayed TCP ACK Support"
	depends on MT76X2_AP
	default n

config  MT76X2_AP_SINGLE_SKU
	bool "Single SKU"
	depends on MT76X2_AP

config  MT76X2_AP_READ_MAC_FROM_MTD
	bool "Read and set MAC from MTD/EEPROM"
	depends on MT76X2_AP
	default y

config  MT76X2_AP_BIG_ENDIAN
	bool "Big-endian platform Support"
	depends on MT76X2_AP
	default n

config  MT76X2_AP_MC_SUPPORT
	bool "Multiple Card Support"
	default n
	depends on MT76X2_AP

config  MT76X2_AP_ATE
	bool "Provide ATE testmode commands support"
	depends on MT76X2_AP
	default n

config  MT76X2_AP_QA
	bool "Provide QA tool support"
	depends on MT76X2_AP
	depends on MT76X2_AP_ATE
	default n

config  MT76X2_AP_DBG
	bool "Debug support for AP mode"
	depends on MT76X2_AP
	default n
```

## trunk/linux-3.4.x/drivers/net/wireless/ralink/Kconfig
```kconfig
config RT_SINGLE_SKU
	bool "Single SKU regspec"
	default n

config RT_MAX_CLIENTS
	int "Maximum Wireless clients (16/32/48/64/128). More clients - more MEM and CPU usage"
	default 32

config RT_BAND_STEERING
	bool "Band Steering support"
	depends on !RT_SECOND_IF_NONE
	default n

config RT_DOT11R_FT
	bool "802.11r Fast BSS Transition support"
	default n

config RT_DOT11K_RRM
	bool "802.11k Radio Resource Management support"
	default n

config RT_80211N_DRAFT3
	bool "802.11n Draft3 (BSS Coexistence)"
	default n

config RT_80211W_PMF
	bool "802.11w Protected Management Frames (PMF) support"
	default n

#config RT_WAPI
#	bool "WAPI support"
#	default n

config RT_WSC
	bool "WSC (WiFi Simple Config)"
	default n

config RT_WSC_V2
	bool "WSC V2 (WiFi Simple Config Version 2)"
	depends on RT_WSC
	default n

config RT_WSC_NFC
	bool "WSC out-of-band (NFC)"
	depends on RT_WSC
	default n

config RT_ED_MONITOR
	bool "ED CCA Monitor support"
	default n

config RT_IGMP_SNOOP
	bool "IGMP snooping (M2U in wireless driver)"
	default n

config RT_MCAST_RATE_SPECIFIC
	bool "User specific TX rate of mcast packets"
	default n

config RT_DELAYED_TCP_ACK
	bool "Delayed TCP ACK support"
	default n

#config RT_HDR_TRANS
#	bool "Header Translation RX support"
#	default n

#config RT_CSO
#	bool "Checksum offload (CSO) support"
#	default n

config RT_NETIF_BLOCK
	bool "NETIF Block"
	default n
	help
	  Support Net interface block while Tx-Sw queue full

#config RT_VIDEO_TURBINE
#	bool "Video Turbine support"
#	default n

config RT_SNMP
	bool "Support SNMPD counters"
	default n

config RT_CFG80211
	bool "CFG80211 support (Linux wireless configuration API)"
	depends on CFG80211
	default n

config RT_READ_MAC_FROM_MTD
	bool "Read and set MAC address from MTD/EEPROM"
	default y

config RT_MEMORY_OPTIMIZATION
	bool "Memory optimization (shrink ring size). Need for < 32Mb RAM devices"
	default n

#config RT_BIG_ENDIAN
#	bool "Big-endian platform support"
#	default n

#config RT_MC_SUPPORT
#	bool "Multiple PCIe card support"
#	default n

#config RT_ATE
#	bool "Provide ATE testmode commands support"
#	default n

#config RT_QA
#	bool "Provide QA tool support"
#	depends on RT_ATE
#	default n

config RT_DEBUG
	bool "Include Debug messages"
	default n
```

## trunk/linux-3.4.x/drivers/net/wireless/ralink/mt7615/os/linux/Kconfig.mt_wifi_ap
```kconfig
config MT_AP_SUPPORT
	tristate "Ralink RT2860 802.11n AP support"
#	depends on NET_RADIO 
	select WIRELESS_EXT
	select WEXT_SPY
	select WEXT_PRIV

config WDS_SUPPORT
	bool "WDS"
	depends on MT_AP_SUPPORT
	default n

config MBSS_SUPPORT
	bool "MBSSID"
	depends on MT_AP_SUPPORT
	default y

#config NEW_MBSSID_MODE
#	bool "New MBSSID MODE"
#	depends on MT_AP_SUPPORT && MBSS_SUPPORT
#	depends on RALINK_RT3883 || RALINK_RT3352 || RALINK_RT5350 || RALINK_RT6352 || RALINK_MT7620
#	default y

#config ENHANCE_NEW_MBSSID_MODE
#	bool "Enhanced MBSSID mode"
#	depends on NEW_MBSSID_MODE
#	default y

config APCLI_SUPPORT
	bool "AP-Client Support"
	depends on MT_AP_SUPPORT
	default y

config APCLI_CERT_SUPPORT
        bool "AP-Client TGn Cert Support"
	depends on MT_AP_SUPPORT
        depends on APCLI_SUPPORT
        default n

config MAC_REPEATER_SUPPORT
	bool "MAC Repeater Support"
	depends on MT_AP_SUPPORT
	depends on APCLI_SUPPORT
	depends on RALINK_RT6352 || RALINK_MT7620 || RALINK_MT7603E || MT_AP_SUPPORT
	default y

config MWDS
    bool "Mixed WDS(MWDS)"
    depends on MT_AP_SUPPORT
    select APCLI_SUPPORT
    default n

config MUMIMO_SUPPORT
        bool "MU-MIMO Support"
        depends on WIFI_DRIVER
        select MU_RA_SUPPORT
        default y

config MU_RA_SUPPORT
  	bool "MU-RGA Support"
  	depends on MUMIMO_SUPPORT
  	
config DOT11R_FT_SUPPORT
	bool "802.11r Fast BSS Transition"
	depends on MT_AP_SUPPORT
	default n

config DOT11K_RRM_SUPPORT
	bool "802.11k Radio Resource Management"
	depends on MT_AP_SUPPORT
	default n

#config SNIFFER_SUPPORT
#	bool "SNIFFER"
#	depends on MT_AP_SUPPORT
#	default n

config CFG80211_SUPPORT
	bool "CFG80211"
	depends on MT_AP_SUPPORT
	default n

config CUSTOMIZED_HOSTAPD
	bool "Customized Hostapd Support"
	depends on CFG80211_SUPPORT
	default n

config DSCP_QOS_MAP_SUPPORT
	bool "Dscp Qos Mapping Support"
	depends on MT_AP_SUPPORT
	default n

config CON_WPS_SUPPORT
	bool "Concurrent WPS Support"
	depends on MT_AP_SUPPORT
	depends on APCLI_SUPPORT
	depends on WSC_INCLUDED
	depends on WSC_V2_SUPPORT
#	depends on MULTI_INF_SUPPORT
	default n
	
#config LLTD_SUPPORT
#	bool "LLTD (Link Layer Topology Discovery Protocol)"
#	depends on MT_AP_SUPPORT

#config COC_SUPPORT
#	bool "CoC Support"
#	depends on MT_AP_SUPPORT
#	default n

#config  RT2860V2_SNMP
#	bool "Net-SNMP Support"
#	depends on MT_AP_SUPPORT

config MCAST_RATE_SPECIFIC
	bool "User specific tx rate of mcast pkt"
	depends on MT_AP_SUPPORT
	default y

#config EXT_BUILD_CHANNEL_LIST
#	bool "Extension Channel List"
#	depends on MT_AP_SUPPORT

#config AUTO_CH_SELECT_ENHANCE
#	bool "Auto Channel Selection Enhancement"
#	depends on MT_AP_SUPPORT

config VOW_SUPPORT
	bool "MediaAir(VOW) support"
	depends on MT_AP_SUPPORT
	default y

#config AIRPLAY_SUPPORT
#	bool "AIRPLAY Support"
#	depends on MT_AP_SUPPORT
#	default n

config BAND_STEERING
	bool "Band Steering"
	depends on MT_AP_SUPPORT
	default n

config RADIO_LINK_SELECTION
        bool "RADIO_LINK_SELECTION"
        depends on MT_AP_SUPPORT
        default n

config LED_CONTROL_SUPPORT
        bool "LED Control Support"
        default y

config GPIO_CONTROL_SUPPORT
	bool "GPIO Control Support"
	depends on MT_AP_SUPPORT
	default n

config RADIUS_ACCOUNTING_SUPPORT
	bool "Radius Accounting Support"
	depends on MT_AP_SUPPORT
	default n
        
config GREENAP_SUPPORT
	bool "GreenAP Support"
	depends on MT_AP_SUPPORT
	default y

config ROAMING_ENHANCE_SUPPORT
	bool "Roaming Enhance Support"
	depends on MT_AP_SUPPORT
	depends on APCLI_SUPPORT
	default n

config EASY_SETUP_SUPPORT
	bool "Whole Home Coverage - Easy Setup"
	depends on MT_AP_SUPPORT
	default n    

config EASY_MODULE_SUPPORT
	bool "Whole Home Coverage - Easy Setup Module Support"
	depends on EASY_SETUP_SUPPORT
	default n    
config EVENT_NOTIFIER_SUPPORT
	bool "Whole Home Coverage - Event Notifier"
	depends on MT_AP_SUPPORT
	default n

config AIR_MONITOR
        bool "Air Monitor"
        depends on MT_AP_SUPPORT
        default n

config WNM_SUPPORT
        bool "802.11v WNM Support"
        depends on MT_AP_SUPPORT
        default n
		
config STA_FORCE_ROAM_SUPPORT
        bool "Station Force Roam Support"
        depends on MT_AP_SUPPORT
        default n

config LINUX_NET_TXQ_SUPPORT
	bool "NET TX Queue Support"
	default y
```

## trunk/linux-3.4.x/drivers/net/wireless/rt3090_ap/Kconfig
```kconfig
config RT3090_AP
	tristate "Ralink RT309X 802.11n AP support"
	select WIRELESS_EXT
	select WEXT_SPY
	select WEXT_PRIV

config  RT3090_AP_RT3390
	bool "RT3390 Support"
	default n
	depends on RT3090_AP

config  RT3090_AP_LED
	bool "LED Support"
	depends on RT3090_AP

config  RT3090_AP_WSC
	bool "WSC (WiFi Simple Config)"
	depends on RT3090_AP

config  RT3090_AP_WSC_V2
	bool "WSC V2 (WiFi Simple Config Version 2)"
	default n
	depends on RT3090_AP_WSC

config  RT3090_AP_LLTD
	bool "LLTD (Link Layer Topology Discovery Protocol)"
	depends on RT3090_AP

config  RT3090_AP_WDS
	bool "WDS"
	depends on RT3090_AP

config  RT3090_AP_MBSS
	bool "MBSSID"
	depends on RT3090_AP

config  RT3090_AP_APCLI
	bool "AP-CLient Support"
	depends on RT3090_AP

config  RT3090_AP_IGMP_SNOOP
	bool "IGMP snooping"
	depends on RT3090_AP

config  RT3090_AP_NETIF_BLOCK
	bool "NETIF Block"
	depends on RT3090_AP
	help
	Support Net interface block while Tx-Sw queue full

config  RT3090_AP_VIDEO_TURBINE
	bool "Video Turbine support"
	depends on RT3090_AP

config  RT3090_AP_DLS
	bool "DLS (Direct-Link Setup) Support"
	depends on RT3090_AP

config  RT3090_AP_IDS
	bool "IDS (Intrusion Detection System) Support"
	depends on RT3090_AP

config  RT3090_AP_GREENAP
	bool "Green AP mode support"
	depends on RT3090_AP

config  RT3090_AP_AUTO_CH_SELECT_ENHANCE
	bool "Auto Channel Selection Enhancement"
	default y
	depends on RT3090_AP

config  RT3090_AP_80211N_DRAFT3
	bool "802.11n Draft3"
	depends on RT3090_AP

config  RT3090_AP_MCAST_RATE_SPECIFIC
	bool "User specific TX rate of mcast packets"
	default y
	depends on RT3090_AP

config  RT3090_AP_READ_MAC_FROM_MTD
	bool "Read and set MAC from MTD/EEPROM"
	default y
	depends on RT3090_AP

#config  RT3090_AP_BRIDGE_FASTPATH
#	bool "Bridge wlan2lan operation offload"
#	depends on RT3090_AP

config  RT3090_AP_MC_SUPPORT
	bool "Multiple Card Support"
	default n
	depends on RT3090_AP

config  RT3090_AP_ATE
	bool "Provide ATE + QA testmode commands support"
	default n
	depends on RT3090_AP

config  RT3090_AP_DBG
	bool "Debug support for AP mode"
	default n
	depends on RT3090_AP
```

## trunk/linux-3.4.x/drivers/net/wireless/rt5592_ap/Kconfig
```kconfig
config RT5592_AP
	tristate "Ralink RT5592 802.11n AP support"
	select WIRELESS_EXT
	select WEXT_SPY
	select WEXT_PRIV

config  RT5592_AP_LED
	bool "LED Support"
	depends on RT5592_AP

config  RT5592_AP_WSC
	bool "WSC (WiFi Simple Config)"
	depends on RT5592_AP

config  RT5592_AP_WSC_V2
	bool "WSC V2 (WiFi Simple Config Version 2)"
	default n
	depends on RT5592_AP_WSC

config  RT5592_AP_LLTD
	bool "LLTD (Link Layer Topology Discovery Protocol)"
	depends on RT5592_AP

config  RT5592_AP_WDS
	bool "WDS"
	depends on RT5592_AP

config  RT5592_AP_MBSS
	bool "MBSSID"
	depends on RT5592_AP

config  RT5592_AP_MBSS_NEW_MBSSID_MODE
	bool "New MBSSID mode support"
	default n
	depends on RT5592_AP_MBSS

config  RT5592_AP_APCLI
	bool "AP-Client Support"
	depends on RT5592_AP

config  RT5592_AP_IGMP_SNOOP
	bool "IGMP snooping"
	depends on RT5592_AP

config  RT5592_AP_NETIF_BLOCK
	bool "NETIF Block"
	depends on RT5592_AP
	help
	Support Net interface block while Tx-Sw queue full

config  RT5592_AP_DFS
	bool "DFS support"
	depends on RT5592_AP

config  RT5592_AP_CARRIER
	bool "Carrier Detection support"
	depends on RT5592_AP

#config  RT5592_AP_EXT_CHANNEL_LIST
#	bool "Extension Channel List"
#	depends on RT5592_AP

config  RT5592_AP_VIDEO_TURBINE
	bool "Video Turbine support"
	depends on RT5592_AP

config  RT5592_AP_DLS
	bool "DLS (Direct-Link Setup) Support"
	depends on RT5592_AP

config  RT5592_AP_IDS
	bool "IDS (Intrusion Detection System) Support"
	depends on RT5592_AP

config  RT5592_AP_GREENAP
	bool "Green AP mode support"
	depends on RT5592_AP

config  RT5592_AP_AUTO_CH_SELECT_ENHANCE
	bool "Auto Channel Selection Enhancement"
	default y
	depends on RT5592_AP

config  RT5592_AP_80211N_DRAFT3
	bool "802.11n Draft3"
	depends on RT5592_AP

config  RT5592_AP_MCAST_RATE_SPECIFIC
	bool "User specific TX rate of mcast packets"
	default y
	depends on RT5592_AP

config  RT5592_AP_READ_MAC_FROM_MTD
	bool "Read and set MAC from MTD/EEPROM"
	default y
	depends on RT5592_AP

config  RT5592_AP_EP_SUPPORT
	bool "RT5592 External PA support"
	default n
	depends on RT5592_AP

config  RT5592_AP_SINGLE_SKU
	bool "Single SKU"
	default n
	depends on RT5592_AP

#config  RT5592_AP_BRIDGE_FASTPATH
#	bool "Bridge wlan2lan operation offload"
#	depends on RT5592_AP

config  RT5592_AP_MC_SUPPORT
	bool "Multiple Card Support"
	default n
	depends on RT5592_AP

config  RT5592_AP_ATE
	bool "Provide ATE testmode commands support"
	default n
	depends on RT5592_AP

config  RT5592_AP_QA
	bool "Provide QA tool support"
	default n
	depends on RT5592_AP
	depends on RT5592_AP_ATE

config  RT5592_AP_DBG
	bool "Debug support for AP mode"
	default n
	depends on RT5592_AP
```

## trunk/linux-3.4.x/drivers/nvram/Kconfig
```kconfig
menu "ASUS NVRAM"

config	ASUS_NVRAM_API
	tristate "ASUS NVRAM R/W API"
	depends on MTD_RALINK
	default y
	---help---
	ASUS NVRAM R/W API
endmenu
```

## trunk/linux-3.4.x/fs/exfat/Kconfig
```kconfig
config EXFAT_FS
	tristate "exFAT fs support (GPL code from Samsung)"
	help
	  To compile this file system support as a module, choose M here: the
	  module will be called exfat.

	  If unsure, say Y.
```
