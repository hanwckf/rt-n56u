## trunk/linux-3.4.x/arch/mips/rt2880/Kconfig
```kconfig
if RALINK_RT3052

choice
	prompt "SoC Hardware Type"
	default RT3052_ASIC

config  RT3052_ASIC
	bool "RT305x/RT3350-ASIC"
endchoice

config RALINK_RT3350
	bool "Ralink RT3350 chipset"

endif

#---------------------------

if RALINK_RT3352

choice
	prompt "SoC Hardware Type"
	default RT3352_ASIC

config  RT3352_ASIC
	bool "RT3352-ASIC"
endchoice

endif

#--------------------------

if RALINK_RT3883

choice
	prompt "SoC Hardware Type"
	default RT3883_ASIC

config  RT3883_ASIC
	bool "RT3883/RT3662-ASIC"
endchoice

choice
	prompt "RT3883/RT3662 PCI mode"
	default PCIE_ONLY

	config PCIE_PCI_CONCURRENT
	bool "PCIe RC and PCI HOST CONCURRENT"

	config PCIE_ONLY
	bool "PCIe RC ONLY"

	config PCI_ONLY
	bool "PCI HOST ONLY"

	config PCIE_PCI_NONE
	bool "Non-support PCI/PCIe"
endchoice

endif

#---------------------------

if RALINK_RT5350

choice
	prompt "SoC Hardware Type"
	default RT5350_ASIC

config  RT5350_ASIC
	bool "RT5350-ASIC"
endchoice

endif

#--------------------------

if RALINK_MT7620

choice
	prompt "SoC Hardware Type"
	default MT7620_ASIC

config  MT7620_ASIC
	bool "MT7620-ASIC"
endchoice

endif

#--------------------------

if RALINK_MT7621

choice
	prompt "Soc Hardware Type"
	default MT7621_ASIC

config  MT7621_ASIC
	bool "MT7621-ASIC"
endchoice

config PCIE_PORT0
	bool "PCIe Port0 support"
	default y

config PCIE_PORT1
	bool "PCIe Port1 support"
	default n

config PCIE_PORT2
	bool "PCIe Port2 support"
	default n

config PCIE_PERST_ONLY
	bool "Use single PERST_N pin (GPIO19) to reset PCIe peripherals"
	default y
endif

#--------------------------

if RALINK_MT7628

choice
	prompt "Soc Hardware Type"
	default MT7628_ASIC

config  MT7628_ASIC
	bool "MT7628/MT7688-ASIC"
endchoice

endif

#--------------------------

config  RALINK_MT7620_PLL600
	bool "Set MT7620 CPU clock to 600MHz (Override Uboot config)"
	depends on (RALINK_MT7620)
	default n

config  RALINK_MT7621_PLL900
	bool "Set MT7621 CPU clock to 900MHz (Override Uboot config)"
	depends on (RALINK_MT7621)
	default n

config  RALINK_SYSTICK_COUNTER
	bool "Use 50KHz SoC Systick Counter (Independent from CPU frequency)"
	depends on !(CEVT_GIC || RALINK_RT3052 || RALINK_RT3883)
	select GENERIC_CLOCKEVENTS_BROADCAST if MIPS_GIC_IPI
	default n

config  RALINK_CPUSLEEP
	bool "Enable MIPS sleep mode (Dynamic CPU Frequency)"
	depends on (RALINK_SYSTICK_COUNTER && (RALINK_MT7620 || RALINK_MT7621 || RALINK_MT7628))
	default n

config  CLKSRC_MIPS_GIC
	bool "Use MIPS GIC Counter (64 bit)"
	depends on IRQ_GIC
	select CSRC_GIC
	select CEVT_GIC
	default y

#--------------------------

choice
	prompt "DRAM Size"
	default RT2880_DRAM_64M

config RT2880_DRAM_16M
	bool "16M"

config RT2880_DRAM_32M
	bool "32M"

config RT2880_DRAM_64M
	bool "64M"

config RT2880_DRAM_128M
	bool "128M"
	depends on !(RALINK_RT3052 || RALINK_RT5350)

config RT2880_DRAM_256M
	bool "256M"
	depends on !(RALINK_RT3052 || RALINK_RT5350)

config RT2880_DRAM_512M
	bool "512M (448M + 64M Highmem)"
	depends on RALINK_MT7621
	select LONG_CALLS

endchoice

config RALINK_RAM_SIZE
	int
	default 16 if RT2880_DRAM_16M
	default 32 if RT2880_DRAM_32M
	default 64 if RT2880_DRAM_64M
	default 128 if RT2880_DRAM_128M
	default 256 if RT2880_DRAM_256M
	default 512 if RT2880_DRAM_512M

#--------------------------

choice
	prompt "UART Baud Rate"
	default RT2880_UART_57600

config RT2880_UART_57600
	bool "57600"

config RT2880_UART_115200
	bool "115200"

endchoice

config  RALINK_UART_BRATE
	int
	default 57600 if RT2880_UART_57600
	default 115200 if RT2880_UART_115200

#--------------------------

config  RALINK_TIMER_DFS
	tristate "Ralink DFS Timer"
	default n

config  RALINK_TIMER_WDG
	tristate "Ralink WatchDog Timer"
	default n

config  RALINK_TIMER_WDG_RESET_OUTPUT
	bool "Ralink WatchDog Reset Output GPIO Pin"
	depends on RALINK_TIMER_WDG
	default n

config  RALINK_TIMER_WDG_REBOOT_DELAY
	int "WatchDog Timer Reboot Delay (Unit:1Sec, Max=30Sec)"
	default 15
	depends on RALINK_TIMER_WDG

config  RALINK_TIMER_WDG_REFRESH_INTERVAL
	int "WatchDog Refresh Interval (Unit:1Sec, Max=30Sec)"
	default 4
	depends on RALINK_TIMER_WDG
```

## trunk/linux-3.4.x/drivers/char/ralink/Kconfig
```kconfig
#
# Ralink character devices
#

config RALINK_GPIO
	bool "Ralink SoC GPIO Support"
	default y

config RALINK_GPIOMODE_EPHY
	bool "Configure EPHY as GPIO mode"
	depends on RALINK_GPIO
	depends on (RALINK_MT7620 || RALINK_MT7628)
	default n
config RALINK_GPIOMODE_PCI
	bool "Configure PCI as GPIO mode"
	depends on RALINK_GPIO
	depends on RALINK_RT3883
	default n
config RALINK_GPIOMODE_LNA_G
	bool "Configure LNA_G as GPIO mode"
	depends on RALINK_GPIO
	depends on (RALINK_RT3352 || RALINK_RT3883)
	default n
config RALINK_GPIOMODE_LNA_A
	bool "Configure LNA_A as GPIO mode"
	depends on RALINK_GPIO
	depends on RALINK_RT3883
	default n
config RALINK_GPIOMODE_MDIO
	bool "Configure MDIO as GPIO mode"
	depends on RALINK_GPIO
	depends on !(RALINK_RT5350 || RALINK_MT7621 || RALINK_MT7628)
	default n
config RALINK_GPIOMODE_PA_G
	bool "Configure PA_G as GPIO mode"
	depends on RALINK_GPIO
	depends on (RALINK_RT3352 || RALINK_MT7620 || RALINK_MT7628)
	default n
config RALINK_GPIOMODE_JTAG
	bool "Configure JTAG as GPIO mode"
	depends on RALINK_GPIO
	depends on !(RALINK_MT7620 || RALINK_MT7628)
	default n
config RALINK_GPIOMODE_UARTF
	bool "Configure UARTF as GPIO mode"
	depends on RALINK_GPIO
	depends on !(RALINK_MT7621 || RALINK_MT7628)
	default y
config RALINK_GPIOMODE_SPI
	bool "Configure SPI as GPIO mode"
	depends on RALINK_GPIO
	depends on !(RALINK_MT7621)
	default n
config RALINK_GPIOMODE_SPI_REFCLK
	bool "Configure SPI CS1 as REFCLK_OUT"
	depends on RALINK_GPIO && !RALINK_GPIOMODE_SPI
	depends on RALINK_MT7620
	default y
config RALINK_GPIOMODE_I2C
	bool "Configure I2C as GPIO mode"
	depends on RALINK_GPIO
	default n

config RALINK_GPIO_IRQ
	bool "Ralink GPIO IRQ Support"
	depends on RALINK_GPIO
	default y

config RALINK_GPIO_LED
	bool "Ralink GPIO LED Support"
	depends on RALINK_GPIO
	default n

config RALINK_GPIO_LED_USB
	bool "Ralink GPIO USB LED Support"
	depends on RALINK_GPIO_LED && USB
	default n

config RALINK_GPIO_LED_USB2
	bool "Ralink GPIO USB #2 LED Support"
	depends on RALINK_GPIO_LED_USB
	default n

config RALINK_HSDMA
	tristate "Ralink SoC HSDMA Support"
	depends on RALINK_MT7621
	default n

config RALINK_GDMA
	tristate "Ralink SoC GDMA Support"
	default n

choice
	prompt "GDMA Channel Allocation Mode"
	depends on RALINK_GDMA
	default GDMA_EVERYBODY

	config GDMA_PCM_ONLY
	bool "PCM/Others"
	---help---
	  RT305x/RT3350=>Ch0-Ch7:PCM0/PCM1 
	  RT3352/RT5350/RT3883=>Ch0-Ch7:PCM0/PCM1, Ch8-Ch15:others
	
	config GDMA_PCM_I2S_OTHERS
	bool "PCM/I2S/Others"
	---help---
	  RT305x/RT3350=>4Ch:PCM0 / 2Ch:I2S / 2Ch:Others
	  RT3352/RT5350/RT3883=>4Ch:PCM0 / 2Ch:I2S_Tx / 2Ch:I2S_Rx / 8Ch:Others

	config GDMA_EVERYBODY
	bool "All for Everybody"

	config GDMA_DEBUG
	bool "Debug Mode 0->1..7->0->1..7.."
endchoice

config RALINK_SPI
	tristate "Ralink SoC SPI Support"
	default n

config RALINK_SPI_CS0_HIGH_ACTIVE
	depends on RALINK_SPI
	bool "SPI CS0 (Chip Select) is high active"
	default n

config RALINK_SPI_CS1_HIGH_ACTIVE
	depends on RALINK_SPI
	depends on RALINK_RT3883 || RALINK_RT3352 || RALINK_RT5350 || RALINK_MT7620 || RALINK_MT7621 || RALINK_MT7628
	bool "SPI CS1 (Chip Select) is high active"
	default n

config RALINK_VITESSE_SWITCH_CONNECT_SPI_CS1
	depends on RALINK_SPI
	depends on RALINK_RT3883 || RALINK_RT3352 || RALINK_RT5350 || RALINK_MT7620 || RALINK_MT7621 || RALINK_MT7628
	bool "Vitess Switch CS Pin Connects to SPI CS1"
	default n

config RALINK_SLIC_CONNECT_SPI_CS1
	depends on RALINK_SPI
	depends on RALINK_RT3883 || RALINK_RT3352 || RALINK_RT5350 || RALINK_MT7620 || RALINK_MT7621 || RALINK_MT7628
	bool "SLIC CS Pin Connects to SPI CS1"
	default n

config RALINK_I2C
	tristate "Ralink SoC I2C Support"
	default n
```

## trunk/linux-3.4.x/drivers/mmc/host/mmc-mtk/Kconfig
```kconfig
config MTK_MMC
	tristate "MediaTek SD/MMC host controller"
	depends on MMC && (RALINK_MT7620 || RALINK_MT7621 || RALINK_MT7628) && !(MTD_NAND_RALINK || MTD_NAND_MTK)

config MTK_AEE_KDUMP
	bool "MTK AEE KDUMP"
	depends on MTK_MMC

config MTK_MMC_CD_POLL
	bool "Card detect with Polling"
	depends on MTK_MMC

config MTK_MMC_EMMC_8BIT
	bool "eMMC 8-bit support"
	depends on MTK_MMC && RALINK_MT7628
```

## trunk/linux-3.4.x/drivers/mtd/ralink/Kconfig
```kconfig
menu "Ralink MTD support"

config MTD_RALINK
	bool "Ralink MTD support"
	default y
	depends on MTD

if MTD_RALINK

choice
	prompt "Flash Type"
	default MTD_SPI_RALINK

	config MTD_NOR_RALINK
		bool "NOR Flash"
		depends on (RALINK_RT3052 || RALINK_RT3883)
		select MTD_CFI

	config MTD_SPI_RALINK
		bool "SPI Flash"

	config MTD_NAND_RALINK
		bool "NAND Flash"
		depends on !(RALINK_RT3352 || RALINK_RT5350 || RALINK_MT7621 || RALINK_MT7628)

	config MTD_NAND_MTK
		bool "NAND Flash"
		depends on (RALINK_MT7621)
		select MTD_NAND
		select MTD_NAND_IDS
		select MTD_NAND_ECC
endchoice

config MTD_SPI_FAST_CLOCK
	bool "Use SPI fast clock, up to 50MHz"
	default n
	depends on MTD_SPI_RALINK

choice
	prompt "SPI Read Mode"
	default MTD_SPI_READ_NORM
	depends on MTD_SPI_RALINK

	config MTD_SPI_READ_NORM
		bool "Normal Read, opcode 0x03"
	config MTD_SPI_READ_FAST
		bool "Fast Read, opcode 0x0B"
	config MTD_SPI_READ_DOR
		bool "Fast Read Dual Out, opcode 0x3B"
		depends on RALINK_MT7620
	config MTD_SPI_READ_DIOR
		bool "Fast Read Dual I/O, opcode 0xBB"
		depends on RALINK_MT7620
endchoice

choice
	prompt "Flash Size"
	default RT2880_FLASH_AUTO

	config RT2880_FLASH_4M
		bool "4M"
		depends on (MTD_SPI_RALINK || MTD_NOR_RALINK)
	config RT2880_FLASH_8M
		bool "8M"
		depends on (MTD_SPI_RALINK || MTD_NOR_RALINK)
	config RT2880_FLASH_16M
		bool "16M"
		depends on (MTD_SPI_RALINK || MTD_NOR_RALINK)
	config RT2880_FLASH_32M
		bool "32M"
		depends on MTD_SPI_RALINK
	config RT2880_FLASH_AUTO
		bool "Autodetect Size"
endchoice

config RT2880_MTD_PHYSMAP_START
	hex
	default 0xBF000000 if RALINK_RT3052
	default 0x1FC00000 if RALINK_MT7621
	default 0x1C000000 if !RALINK_RT3052

config RT2880_MTD_PHYSMAP_LEN
	hex
	default 0x0400000 if RALINK_MT7621
	default 0x1000000 if !RALINK_MT7621

config RT2880_MTD_PHYSMAP_BUSWIDTH
	int
	default 2

choice
	prompt "Root File System Type"
	default RT2880_ROOTFS_IN_FLASH

	config  RT2880_ROOTFS_IN_RAM
		bool "RootFS_in_RAM"
		select BLK_DEV_INITRD
		select BLK_DEV_RAM

	config  RT2880_ROOTFS_IN_FLASH
		bool "RootFS_in_FLASH"
endchoice

config ROOTFS_IN_FLASH_NO_PADDING
	bool "No Padding between Kernel and RootFS"
	default y
	depends on RT2880_ROOTFS_IN_FLASH && !MTD_NAND_USE_UBI_PART

config MTD_NAND_USE_UBI_PART
	bool "Use UBI partitions (U-Boot must support boot from UBI!)"
	default n
	depends on (MTD_NAND_RALINK || MTD_NAND_MTK)
	select MTD_UBI
	select MTD_UBI_GLUEBI

config MTD_NETGEAR_LAYOUT
	bool "NETGEAR flash layout"
	default n
	depends on (MTD_NAND_RALINK || MTD_NAND_MTK) && !MTD_NAND_USE_UBI_PART

config MTD_NAND_USE_XIAOMI_PART
	bool "Use xiaomi NAND partitions"
	default n
	depends on (MTD_NAND_RALINK || MTD_NAND_MTK) && !MTD_NAND_USE_UBI_PART

config MTD_FACTORY_OFFSET
	hex "MTD 'Factory' Partition Offset (Unit:Bytes), for NETGEAR layout"
	default 0x4600000
	depends on (MTD_NETGEAR_LAYOUT)

config MTD_RWFS_OFFSET
	hex "MTD 'RWFS' Partition Offset (Unit:Bytes), for NETGEAR layout"
	default 0x5400000
	depends on (MTD_NETGEAR_LAYOUT)

config MTD_CONFIG_PART_BELOW
	bool "Place 'Config' Partition after 'Kernel+RootFS' Partition"
	default n
	depends on (MTD_NAND_RALINK || MTD_NAND_MTK) && !MTD_NAND_USE_UBI_PART && !MTD_NAND_USE_XIAOMI_PART

config MTD_BOOTLOADER_PART_SIZ
	hex "MTD 'Bootloader' Partition Size (Unit:Bytes)"
	default 0x0080000
	depends on (MTD_NAND_RALINK || MTD_NAND_MTK)

config MTD_BOOTENV_PART_SIZ
	hex "MTD 'BootEnv' Partition Size (Unit:Bytes)"
	default 0x0080000
	depends on (MTD_NAND_RALINK || MTD_NAND_MTK) && !MTD_NAND_USE_UBI_PART

config MTD_CONFIG_PART_SIZ
	hex "MTD 'Config' Partition Size (Unit:Bytes)"
	default 0x0100000
	depends on (MTD_NAND_RALINK || MTD_NAND_MTK) && !MTD_NAND_USE_UBI_PART

config MTD_FACTORY_PART_SIZ
	hex "MTD 'Factory' Partition Size (Unit:Bytes)"
	default 0x0080000
	depends on (MTD_NAND_RALINK || MTD_NAND_MTK) && !MTD_NAND_USE_UBI_PART

config MTD_RESERVED_PART_SIZ
	hex "MTD 'Reserved' Partition Size (Unit:Bytes), for xiaomi boards"
	default 0x04c0000
	depends on (MTD_NAND_RALINK || MTD_NAND_MTK) && !MTD_NAND_USE_UBI_PART && MTD_NAND_USE_XIAOMI_PART

config MTD_KERNEL_PART_SIZ
	hex "MTD 'Kernel' Partition Size (Unit:Bytes)"
	default 0x0120000
	depends on RT2880_ROOTFS_IN_FLASH && !ROOTFS_IN_FLASH_NO_PADDING && !MTD_NAND_USE_UBI_PART

config MTD_FIRMWARE_PART_SIZ
	hex "MTD 'Kernel+RootFS' Partition Size (Unit:Bytes). Max 32MiB."
	default 0x1000000
	depends on (MTD_NAND_RALINK || MTD_NAND_MTK) && !MTD_NAND_USE_UBI_PART

config MTD_STORE_PART_SIZ
	hex "MTD 'Storage' Partition Size (Unit:Bytes)"
	default 0x0200000 if  (MTD_NAND_RALINK || MTD_NAND_MTK)
	default 0x0010000 if !(MTD_NAND_RALINK || MTD_NAND_MTK)
	depends on !MTD_NAND_USE_UBI_PART

endif

endmenu
```

## trunk/linux-3.4.x/drivers/net/rt_eip/Kconfig
```kconfig
config RALINK_HWCRYPTO
	depends on (XFRM && INET_ESP)
	depends on (RALINK_MT7621)
	tristate "EIP93 IPsec HW Crypto Engine"
	default n

config RALINK_HWCRYPTO_ESP6
	depends on RALINK_HWCRYPTO
	depends on IPV6
	bool "Offload ESP6 via Crypto Engine"
	default n

config RALINK_HWCRYPTO_DEBUG
	depends on RALINK_HWCRYPTO
	default n
	bool "Include additional debug messages"
```
