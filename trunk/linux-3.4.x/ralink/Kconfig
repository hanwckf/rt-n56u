## trunk/proprietary/rt_wifi/rtsoc/2.7.X.X/rt2860v2_ap/Kconfig
```kconfig
config RT2860V2_AP
	tristate "Ralink APSoC 802.11n AP support"
	select WIRELESS_EXT
	select WEXT_SPY
	select WEXT_PRIV

config  RT2860V2_AP_LED
	bool "LED Support"
	depends on RT2860V2_AP

config  RT2860V2_AP_LED_SOFT
	bool "Soft LED Support"
	depends on RT2860V2_AP && !RT2860V2_AP_LED && RALINK_GPIO_LED
	default n

config  RT2860V2_AP_LED_SOFT_GPIO
	int "Soft LED GPIO pin"
	depends on RT2860V2_AP && RT2860V2_AP_LED_SOFT
	default -1

config  RT2860V2_AP_WSC
	bool "WSC (WiFi Simple Config)"
	depends on RT2860V2_AP

config  RT2860V2_AP_WSC_V2
	bool "WSC 2.0 (WiFi Simple Config 2.0)"
	default n
	depends on RT2860V2_AP_WSC

config  RT2860V2_AP_LLTD
	bool "LLTD (Link Layer Topology Discovery Protocol)"
	depends on RT2860V2_AP

config  RT2860V2_AP_WDS
	bool "WDS"
	depends on RT2860V2_AP

config  RT2860V2_AP_MBSS
	bool "MBSSID"
	depends on RT2860V2_AP

config  RT2860V2_AP_MBSS_NEW_MBSSID_MODE
	bool "New MBSSID mode"
	default n
	depends on RT2860V2_AP_MBSS
	depends on RALINK_RT3883 || RALINK_RT3352 || RALINK_RT5350 || RALINK_MT7620

config  RT2860V2_AP_APCLI
	bool "AP-CLient Support"
	depends on RT2860V2_AP

config  RT2860V2_AP_MAC_REPEATER
	bool "MAC Repeater Support"
	depends on RT2860V2_AP_APCLI
	depends on RALINK_MT7620
	default n

config  RT2860V2_AP_DFS
	bool "DFS support"
	depends on RT2860V2_AP
	depends on RALINK_RT3883
	select RALINK_TIMER_DFS
	help
	Support dynamic frequency selection

config  RT2860V2_AP_CARRIER
	bool "Carrier Detection support"
	depends on RT2860V2_AP
	select RALINK_TIMER_DFS
	help
	Carrier Sense Multi-Access/Collision Detection.

#config  RT2860V2_AP_EXT_CHANNEL_LIST
#	bool "Extension Channel List"
#	depends on RT2860V2_AP

config  RT2860V2_AP_DLS
	bool "DLS (Direct-Link Setup) Support"
	depends on RT2860V2_AP

config  RT2860V2_AP_IDS
	bool "IDS (Intrusion Detection System) Support"
	depends on RT2860V2_AP

config  RT2860V2_AP_ANTENNA_DIVERSITY
	bool "Antenna Diversity Support"
	depends on RT2860V2_AP
	depends on RALINK_RT5350

config  RT2860V2_AP_GREENAP
	bool "Green AP mode support"
	depends on RT2860V2_AP

config  RT2860V2_AP_VIDEO_TURBINE
	bool "Video Turbine support"
	depends on RT2860V2_AP

config  RT2860V2_AP_TXBF
	bool "Tx Beam Forming Support (Only 3883)"
	depends on RT2860V2_AP
	depends on RALINK_RT3883

choice
	prompt "Choose Power Design"
	depends on RT2860V2_AP
	depends on RALINK_MT7620
	default INTERNAL_PA_INTERNAL_LNA
config  INTERNAL_PA_INTERNAL_LNA
	bool "Internal PA and Internal LNA"
config  INTERNAL_PA_EXTERNAL_LNA
	bool "Internal PA and External LNA"
config  EXTERNAL_PA_EXTERNAL_LNA
	bool "External PA and External LNA"
endchoice

config  RT2860V2_AP_RTMP_INTERNAL_TX_ALC
	bool "TSSI Compensation (Internal TX ALC)"
	depends on RT2860V2_AP
	depends on RALINK_RT3350 || RALINK_RT3352 || RALINK_RT5350 || RALINK_MT7620
	depends on !EXTERNAL_PA_EXTERNAL_LNA
	default n

config  RT2860V2_AP_RTMP_TEMPERATURE_COMPENSATION
	bool "Temperature Compensation (External TX ALC)"
	depends on RT2860V2_AP
	depends on RALINK_MT7620
	default n

config  RT2860V2_AP_ADJ_PWR_CONSUMPTION_SUPPORT
	bool "Reduce Power Consumption"
	depends on RT2860V2_AP
	depends on RALINK_MT7620
	default n

config  RT2860V2_AP_80211N_DRAFT3
	bool "802.11n Draft3"
	depends on RT2860V2_AP
	default n

config  RT2860V2_AP_IGMP_SNOOP
	bool "IGMP snooping"
	depends on RT2860V2_AP
	default n

config  RT2860V2_AP_MCAST_RATE_SPECIFIC
	bool "User specific TX rate of mcast packets"
	default n
	depends on RT2860V2_AP

config  RT2860V2_AP_NETIF_BLOCK
	bool "NETIF Block"
	depends on RT2860V2_AP
	help
	Support Net interface block while Tx-Sw queue full

config  RT2860V2_AP_READ_MAC_FROM_MTD
	bool "Read and set MAC from MTD/EEPROM"
	default y
	depends on RT2860V2_AP

config  RT2860V2_AP_SINGLE_SKU
	bool "Single SKU"
	default n
	depends on RT2860V2_AP

#config  RT2860V2_AP_SNMP
#	bool "Net-SNMP Support"
#	depends on RT2860V2_AP

#config  RT2860V2_AP_BRIDGE_FASTPATH
#	bool "Bridge wlan2lan operation offload"
#	depends on RT2860V2_AP

config  RT2860V2_AP_MEMORY_OPTIMIZATION
	bool "Memory Optimization"
	depends on RT2860V2_AP
	default n

config  RT2860V2_AP_ATE
	bool "Provide ATE testmode commands support"
	default n
	depends on RT2860V2_AP

config  RT2860V2_AP_QA
	bool "Provide QA tool support"
	default n
	depends on RT2860V2_AP
	depends on RT2860V2_AP_ATE

config  RT2860V2_AP_DBG
	bool "Debug support for AP mode"
	default n
	depends on RT2860V2_AP
```

## trunk/proprietary/rt_wifi/rtsoc/2.7.X.X/rt2860v2_sta/Kconfig
```kconfig
config RT2860V2_STA
	tristate "Ralink APSoC 802.11 STA driver"
	select WIRELESS_EXT
	select WEXT_SPY
	select WEXT_PRIV

config  RT2860V2_STA_WPA_SUPPLICANT
	bool "WPA Supplicant"
	depends on RT2860V2_STA

config  RT2860V2_STA_LED
	bool "LED Support"
	depends on RT2860V2_STA

config  RT2860V2_STA_DLS
	bool "DLS (Direct-Link Setup) Support"
	depends on RT2860V2_STA

#config  RT2860V2_STA_CARRIER
#	bool "Carrier Sense Support"
#	depends on RT2860V2_STA
#	select RALINK_TIMER_DFS

config  RT2860V2_STA_ANTENNA_DIVERSITY
	bool "Antenna Diversity Support"
	depends on RT2860V2_STA
	depends on RALINK_RT5350

config  RT2860V2_STA_RTMP_INTERNAL_TX_ALC
	bool "TSSI Compensation"
	depends on RT2860V2_STA
	depends on RALINK_RT3350 || RALINK_RT3352 || RALINK_RT5350 || RALINK_MT7620

config  RT2860V2_STA_TXBF
	bool "Tx Bean Forming Support (Only 3883)"
	depends on RT2860V2_STA
	depends on RALINK_RT2883 || RALINK_RT3883

#config  RT2860V2_STA_EXT_CHANNEL_LIST
#	bool "Extension Channel List"
#	depends on RT2860V2_STA

config  RT2860V2_STA_P2P
	bool "Wireless Direct(P2P)"
	depends on RT2860V2_STA
```

## trunk/user/antfs/antfs-07.19/Kconfig
```kconfig
config ANTFS_FS
	tristate "NTFS file system by AVM"
	default n
	help
	  NTFS is the file system of Microsoft Windows NT, 2000, XP and 2003.
	  
	  This driver supports reading/writing files with following main
	  exceptions - You cannot:
	  *write compressed files
	  *access encrypted files
	  *create links (reparse points/junctions)
	  *use ACLs (everything is RWXRWXRWX)

	  If you don't use a NTFS partition, say N.

config ANTFS_SYMLINKS
	bool "Support reading symlinks in antfs"
	default n
	depends on ANTFS_FS
```

## uboot/rt-n65u/config.in
```kconfig
string 'Cross Compiler Path' CONFIG_CROSS_COMPILER_PATH  /opt/buildroot-gcc342/bin
comment ""

mainmenu_name 'Uboot Configuration'
choice 'Chip Type' "ASIC ASIC_BOARD"

if [ "$FPGA_BOARD" = "y" ]; then
choice 'Chip ID'	 "RT2880 RT2880_FPGA_BOARD \
                          RT3052 RT3052_FPGA_BOARD \
                          RT3352 RT3352_FPGA_BOARD \
                          RT3883 RT3883_FPGA_BOARD \
                          RT5350 RT5350_FPGA_BOARD 
                         "
else
choice 'Chip ID'	" RT2880 RT2880_ASIC_BOARD \
                          RT3350 RT3350_ASIC_BOARD \
                          RT3052 RT3052_ASIC_BOARD \
                          RT3352 RT3352_ASIC_BOARD \
                          RT3883 RT3883_ASIC_BOARD \
                          RT5350 RT5350_ASIC_BOARD 
                         "
fi

#########
# RT2880
#########
if [ "$RT2880_FPGA_BOARD" = "y" -o \
     "$RT2880_ASIC_BOARD" = "y" ]; then
define_bool RT2880_MP y
define_bool ON_BOARD_NOR_FLASH_COMPONENT y

choice 'GMAC connected to ' "100Switch   MAC_TO_100SW_MODE \
			     100Phy  MAC_TO_100PHY_MODE \
			     GigaSW  MAC_TO_VITESSE_MODE \
			     GigaPhy MAC_TO_GIGAPHY_MODE 
			    "
fi

#################
# RT3350
#################
if [ "$RT3350_ASIC_BOARD" = "y" ]; then
	define_bool RT3052_ASIC_BOARD y
fi


#################
# RT5350
#################
if [ "$RT5350_FPGA_BOARD" = "y" -o \
     "$RT5350_ASIC_BOARD" = "y" ]; then
define_bool RT5350_MP y
define_bool ON_BOARD_SPI_FLASH_COMPONENT y
define_bool P5_MAC_TO_NONE_MODE y
fi

#########
# RT3352
#########
if [ "$RT3352_FPGA_BOARD" = "y" -o \
     "$RT3352_ASIC_BOARD" = "y" ]; then

define_bool RT3352_MP y
choice 'Port 5 Connect to' "None		P5_MAC_TO_NONE_MODE \
			    Giga_Phy(RGMII)	P5_MAC_TO_PHY_MODE \
	       	      	    Giga_SW/iNIC(RGMII)	P5_RGMII_TO_MAC_MODE \
		            External_CPU(MII_RvMII) P5_MII_TO_MAC_MODE \
		            External_CPU(RvMII_MII) P5_RMII_TO_MAC_MODE
		      	   " None
                       
define_bool MAC_TO_100SW_MODE n
define_bool MAC_TO_100PHY_MODE n
define_bool MAC_TO_VITESSE_MODE n
define_bool MAC_TO_GIGAPHY_MODE n
if [ "$P5_MAC_TO_PHY_MODE" = "y" ]; then
   hex "GigaPHY address for Auto Polling" MAC_TO_GIGAPHY_MODE_ADDR 0x1f
fi

define_bool ON_BOARD_SPI_FLASH_COMPONENT y

fi

#########
# RT3052
#########
if [ "$RT3052_FPGA_BOARD" = "y" -o \
     "$RT3052_ASIC_BOARD" = "y" ]; then

define_bool RT3052_MP2 y

if [ "$RT3350_ASIC_BOARD" = "y" ]; then
define_bool P5_MAC_TO_NONE_MODE y
else
choice 'Port 5 Connect to' "None		P5_MAC_TO_NONE_MODE \
			    Giga_Phy(RGMII)	P5_MAC_TO_PHY_MODE \
	       	      	    Giga_SW/iNIC(RGMII)	P5_RGMII_TO_MAC_MODE \
		            External_CPU(MII_RvMII) P5_MII_TO_MAC_MODE \
		            External_CPU(RvMII_MII) P5_RMII_TO_MAC_MODE
		      	   " None
fi

define_bool MAC_TO_100SW_MODE n
define_bool MAC_TO_100PHY_MODE n
define_bool MAC_TO_VITESSE_MODE n
define_bool MAC_TO_GIGAPHY_MODE n
if [ "$P5_MAC_TO_PHY_MODE" = "y" ]; then
   if [ "$RT3052_FPGA_BOARD" = "y" ]; then
      define_hex MAC_TO_GIGAPHY_MODE_ADDR  0x0
   else
      hex "GigaPHY address for Auto Polling" MAC_TO_GIGAPHY_MODE_ADDR 0x1f
   fi
fi
fi

#########
# RT3883
#########
if [ "$RT3883_FPGA_BOARD" = "y" -o \
     "$RT3883_ASIC_BOARD" = "y" ]; then
define_bool RT3883_MP y
choice 'Use GE1 or GE2' "GMAC1 RT3883_USE_GE1  \
	                 GMAC2 RT3883_USE_GE2
			"
if [ "$RT3883_USE_GE1" = "y" ]; then
choice 'GE1 connected to' "GE_MII_FORCE_100	 GE_MII_FORCE_100 \
		           GE_RVMII_FORCE_100 GE_RVMII_FORCE_100 \
		  	   GE_MII_AN		 GE_MII_AN \
		           GE_RGMII_FORCE_1000   GE_RGMII_FORCE_1000 \
		           GE_RGMII_AN		 GE_RGMII_AN 
			  "
else
 choice 'GE2 connected to' "GE_MII_FORCE_100		GE_MII_FORCE_100 \
			    GE_RVMII_FORCE_100		GE_RVMII_FORCE_100 \
  			    GE_MII_AN			GE_MII_AN \
			    GE_RGMII_FORCE_1000		GE_RGMII_FORCE_1000 \
			    GE_RGMII_AN			GE_RGMII_AN 
			   "
fi
if [ "$GE_MII_FORCE_100" = "y" -o \
     "$GE_RVMII_FORCE_100" = "y" ]; then
    define_bool MAC_TO_100SW_MODE y
fi     

if [ "$GE_MII_AN" = "y" ]; then
    define_bool MAC_TO_100PHY_MODE y
fi

if [ "$GE_RGMII_FORCE_1000" = "y" ]; then
    define_bool  MAC_TO_VITESSE_MODE y
fi

if [ "$GE_RGMII_AN" = "y" ]; then
    define_bool  MAC_TO_GIGAPHY_MODE y
fi

fi
#########
# GMAC
#########
if [ "$MAC_TO_VITESSE_MODE" = "y" -o \
     "$P5_RGMII_TO_MAC_MODE" = "y" ]; then
    define_bool GPIOx_RESET_MODE y
fi
if [ "$MAC_TO_100PHY_MODE" = "y" ]; then
    hex "10/100 PHY address for Auto Polling" MAC_TO_GIGAPHY_MODE_ADDR 0x1f
fi
if [ "$MAC_TO_GIGAPHY_MODE" = "y" ]; then
    hex "GigaPHY address for Auto Polling" MAC_TO_GIGAPHY_MODE_ADDR 0x1f
fi

#########
# Switch
#########
choice 'Switch chip' "Realtek_RTL8367RB SWITCH_CHIP_RTL8367RB"

choice 'Control interface' "SMI(SCK:GPIO_NR_2,SDA:GPIO_NR_1) SWITCH_CTRLIF_SMI_SCK2_SDA1 \
			    SMI(SCK:MDC,SDA:MDIO) SWITCH_CTRLIF_SMI_MDC_MDIO \
			    MDIO SWITCH_CTRLIF_MDIO \
			   "

#########
# FLASH
#########
if [ "$RT2880_FPGA_BOARD" != "y" -a "$RT2880_ASIC_BOARD" != "y" -a \
    "$RT3352_FPGA_BOARD" != "y" -a "$RT3352_ASIC_BOARD" != "y" -a \
    "$RT5350_FPGA_BOARD" != "y" -a "$RT5350_ASIC_BOARD" != "y" ]; then
choice 'Flash Type' "NOR ON_BOARD_NOR_FLASH_COMPONENT \
                     NAND ON_BOARD_NAND_FLASH_COMPONENT \
                     SPI ON_BOARD_SPI_FLASH_COMPONENT
		    " 
fi

if [ "$RT2880_FPGA_BOARD" = "y" -o \
     "$RT2880_ASIC_BOARD" = "y" -o "$DUAL_IMAGE_SUPPORT" = "y" ]; then
choice 'Flash Size' "4M ON_BOARD_4M_FLASH_COMPONENT \
                     8M ON_BOARD_8M_FLASH_COMPONENT \
                     16M ON_BOARD_16M_FLASH_COMPONENT 
		    " 
fi

#########
# DRAM
#########
if [ "$RT3883_FPGA_BOARD" = "y" -o "$RT3883_ASIC_BOARD" = "y" -o \
    "$RT3352_FPGA_BOARD" = "y" -o "$RT3352_ASIC_BOARD" = "y" ]; then
choice 'DRAM Type' "SDR ON_BOARD_SDR \
	            DDR ON_BOARD_DDR
		   "
else
define_bool ON_BOARD_SDR y
fi

if [ "$ON_BOARD_NOR_FLASH_COMPONENT" = "y" -o \
     "$ON_BOARD_NAND_FLASH_COMPONENT" = "y" -o \
     "$RT3883_FPGA_BOARD" = "y" -o "$RT3883_ASIC_BOARD" = "y" -o \
     "$RT3352_FPGA_BOARD" = "y" -o "$RT3352_ASIC_BOARD" = "y" -o \
     "$RT5350_FPGA_BOARD" = "y" -o "$RT5350_ASIC_BOARD" = "y" ]; then

if [ "$ON_BOARD_SDR" = "y" ]; then
choice 'DRAM Component' "64Mb ON_BOARD_64M_DRAM_COMPONENT \
                         128Mb ON_BOARD_128M_DRAM_COMPONENT \
                         256Mb ON_BOARD_256M_DRAM_COMPONENT \
                         512Mb ON_BOARD_512M_DRAM_COMPONENT 
		      "
else
choice 'DDR Component' "256Mb ON_BOARD_256M_DRAM_COMPONENT \
                        512Mb ON_BOARD_512M_DRAM_COMPONENT \
                        1024Mb ON_BOARD_1024M_DRAM_COMPONENT \
                        2048Mb ON_BOARD_2048M_DRAM_COMPONENT
		      "
choice 'DDR Width' "8bits ON_BOARD_DDR_WIDTH_8 \
	            16bits ON_BOARD_DDR_WIDTH_16
		   "
fi

if [ "$RT5350_FPGA_BOARD" != "y" -a "$RT5350_ASIC_BOARD" != "y" -a "$RT3350_ASIC_BOARD" != "y" ]; then
choice 'DRAM Bus' "16bits ON_BOARD_16BIT_DRAM_BUS \
                   32bits ON_BOARD_32BIT_DRAM_BUS 
		  " 
else
define_bool	ON_BOARD_16BIT_DRAM_BUS
fi
fi

#########
# Others
#########
choice 'ALL_LED_OFF GPIO' "N/A ALL_LED_OFF_NONE \
			   RXD(GPIO_NR_10) ALL_LED_OFF_RXD_GPIONR10 \
			  "
bool "Reset hardware on GPIO#1" RESET_GPIO_1



###############
# Option
###############
comment ""
if [ "$ON_BOARD_SPI_FLASH_COMPONENT" = "y" -o "$ON_BOARD_NAND_FLASH_COMPONENT" = "y" ]; then
define_bool UBOOT_RAM y
else
choice 'Ram/Rom version' "RAM UBOOT_RAM \
			  ROM UBOOT_ROM 
			 " ROM
fi

bool "Dual Image" DUAL_IMAGE_SUPPORT

if [ "$RT3052_FPGA_BOARD" = "y" -o "$RT3052_ASIC_BOARD" = "y" -o \
     "$RT3352_FPGA_BOARD" = "y" -o "$RT3352_ASIC_BOARD" = "y" -o \
     "$RT5350_FPGA_BOARD" = "y" -o "$RT5350_ASIC_BOARD" = "y" -o \
     "$MAC_TO_100SW_MODE" = "y" ]; then
bool "Partition LAN/WAN" LAN_WAN_PARTITION
if [ "$LAN_WAN_PARTITION" = "y" ]; then
 choice 'LAN/WAN Board Layout' "W/LLLL RALINK_DEMO_BOARD_PVLAN \
		                LLLL/W RALINK_EV_BOARD_PVLAN 
			       "
fi
fi

if [ "$UBOOT_ROM" = "y" ]; then
if [ "$RT3052_FPGA_BOARD" = "y" -o \
     "$RT3052_ASIC_BOARD" = "y" ]; then
define_hex TEXT_BASE  0xBF000000
else
if [ "$RT2883_FPGA_BOARD" = "y" -o "$RT2883_ASIC_BOARD" = "y" -o \
     "$RT3352_FPGA_BOARD" = "y" -o "$RT3352_ASIC_BOARD" = "y" -o \
     "$RT5350_FPGA_BOARD" = "y" -o "$RT5350_ASIC_BOARD" = "y" -o \
     "$RT3883_FPGA_BOARD" = "y" -o "$RT3883_ASIC_BOARD" = "y" ]; then
define_hex TEXT_BASE  0xBC000000
else
define_hex TEXT_BASE  0xBFC00000
fi
fi
fi

if [ "$UBOOT_RAM" = "y" ]; then
if [ "$RT2880_FPGA_BOARD" = "y" -o \
     "$RT2880_ASIC_BOARD" = "y" ]; then
define_hex TEXT_BASE  0x8A200000
else
define_hex TEXT_BASE  0x80200000
fi
fi
```
