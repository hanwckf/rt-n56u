## trunk/proprietary/rt_wifi/rtpci/2.5.X.X/rt5392_ap/Kconfig
```kconfig
config RT5392_AP
	tristate "Ralink RT5392 802.11 AP driver"
	select WIRELESS_EXT
	select WEXT_SPY
	select WEXT_PRIV

config  RT5392_AP_LED
	bool "LED support"
	depends on RT5392_AP

config  RT5392_AP_LLTD
	bool "LLTD (Link Layer Topology Discovery Protocol)"
	depends on RT5392_AP

config  RT5392_AP_WDS
	bool "WDS support"
	depends on RT5392_AP

config  RT5392_AP_WMM_ACM
	bool "WMM ACM"
	depends on RT5392_AP

config  RT5392_AP_MBSS
	bool "MBSSID support"
	depends on RT5392_AP

config  RT5392_AP_MBSS_NEW_MBSSID_MODE
	bool "New MBSSID mode support"
	default n
	depends on RT5392_AP_MBSS

config  RT5392_AP_APCLI
	bool "AP-Client support"
	depends on RT5392_AP

config  RT5392_AP_DLS
	bool "DLS (Direct-Link Setup) support"
	depends on RT5392_AP

config  RT5392_AP_IDS
	bool "IDS (Intrusion Detection System) support"
	depends on RT5392_AP

config  RT5392_AP_GREENAP
	bool "Green AP mode support"
	depends on RT5392_AP
```

## trunk/proprietary/rt_wifi/rtpci/2.7.X.X/rt5392_ap/Kconfig
```kconfig
config RT5392_AP
	tristate "Ralink RT5392 802.11n AP support"
	select WIRELESS_EXT
	select WEXT_SPY
	select WEXT_PRIV

config  RT5392_AP_LED
	bool "LED Support"
	depends on RT5392_AP

config  RT5392_AP_WSC
	bool "WSC (WiFi Simple Config)"
	depends on RT5392_AP

config  RT5392_AP_WSC_V2
	bool "WSC V2 (WiFi Simple Config Version 2)"
	default n
	depends on RT5392_AP_WSC

config  RT5392_AP_LLTD
	bool "LLTD (Link Layer Topology Discovery Protocol)"
	depends on RT5392_AP

config  RT5392_AP_WDS
	bool "WDS"
	depends on RT5392_AP

config  RT5392_AP_MBSS
	bool "MBSSID"
	depends on RT5392_AP

config  RT5392_AP_MBSS_NEW_MBSSID_MODE
	bool "New MBSSID mode support"
	default n
	depends on RT5392_AP_MBSS

config  RT5392_AP_APCLI
	bool "AP-CLient Support"
	depends on RT5392_AP

config  RT5392_AP_IGMP_SNOOP
	bool "IGMP snooping"
	depends on RT5392_AP

config  RT5392_AP_NETIF_BLOCK
	bool "NETIF Block"
	depends on RT5392_AP
	help
	Support Net interface block while Tx-Sw queue full

config  RT5392_AP_VIDEO_TURBINE
	bool "Video Turbine support"
	depends on RT5392_AP

config  RT5392_AP_DLS
	bool "DLS (Direct-Link Setup) Support"
	depends on RT5392_AP

config  RT5392_AP_IDS
	bool "IDS (Intrusion Detection System) Support"
	depends on RT5392_AP

config  RT5392_AP_GREENAP
	bool "Green AP mode support"
	depends on RT5392_AP

config  RT5392_AP_AUTO_CH_SELECT_ENHANCE
	bool "Auto Channel Selection Enhancement"
	default y
	depends on RT5392_AP

config  RT5392_AP_80211N_DRAFT3
	bool "802.11n Draft3"
	depends on RT5392_AP

config  RT5392_AP_MCAST_RATE_SPECIFIC
	bool "User specific TX rate of mcast packets"
	default y
	depends on RT5392_AP

config  RT5392_AP_READ_MAC_FROM_MTD
	bool "Read and set MAC from MTD/EEPROM"
	default y
	depends on RT5392_AP

config  RT5392_AP_SINGLE_SKU
	bool "Single SKU"
	default n
	depends on RT5392_AP

#config  RT5392_AP_BRIDGE_FASTPATH
#	bool "Bridge wlan2lan operation offload"
#	depends on RT5392_AP

config  RT5392_AP_MC_SUPPORT
	bool "Multiple Card Support"
	default n
	depends on RT5392_AP

config  RT5392_AP_ATE
	bool "Provide ATE testmode commands support"
	default n
	depends on RT5392_AP

config  RT5392_AP_QA
	bool "Provide QA tool support"
	default n
	depends on RT5392_AP
	depends on RT5392_AP_ATE

config  RT5392_AP_DBG
	bool "Debug support for AP mode"
	default n
	depends on RT5392_AP
```

## trunk/proprietary/rt_wifi/rtpci/3.0.X.X/mt7610_ap/Kconfig
```kconfig
config MT7610_AP
	tristate "MediaTek MT7610E 802.11ac AP support"
	select WIRELESS_EXT
	select WEXT_SPY
	select WEXT_PRIV

config  MT7610_AP_LED
	bool "LED Support"
	depends on MT7610_AP
	default y

config  MT7610_AP_WSC
	bool "WSC (WiFi Simple Config)"
	depends on MT7610_AP
	default n

config  MT7610_AP_WSC_V2
	bool "WSC V2 (WiFi Simple Config Version 2)"
	depends on MT7610_AP_WSC
	default n

config  MT7610_AP_LLTD
	bool "LLTD (Link Layer Topology Discovery Protocol)"
	depends on MT7610_AP
	default y

config  MT7610_AP_WDS
	bool "WDS"
	depends on MT7610_AP
	default y

config  MT7610_AP_MBSS
	bool "MBSSID"
	depends on MT7610_AP
	default y

config  MT7610_AP_MBSS_NEW_MBSSID_MODE
	bool "New MBSSID mode support"
	depends on MT7610_AP
	depends on MT7610_AP_MBSS
	default n

config  MT7610_AP_APCLI
	bool "AP-Client Support"
	depends on MT7610_AP
	default y

config  MT7610_AP_MAC_REPEATER
	bool "MAC Repeater Mode Support"
	depends on MT7610_AP
	depends on MT7610_AP_APCLI
	default n

config  MT7610_AP_CON_WPS_SUPPORT
	bool "Concurrent WPS Support"
	depends on MT7610_AP
	depends on MT7610_AP_APCLI
	depends on MT7610_AP_WSC
	depends on MT7610_AP_WSC_V2
	default n

config  MT7610_AP_NETIF_BLOCK
	bool "NETIF Block"
	depends on MT7610_AP
	default n
	help
	  Support Net interface block while Tx-Sw queue full

config  MT7610_AP_DFS
	bool "DFS support"
	depends on MT7610_AP
	default n

config  MT7610_AP_CARRIER
	bool "Carrier Detection support"
	depends on MT7610_AP
	default n

config  MT7610_AP_ED_MONITOR
	bool "ED CCA Monitor Support"
	depends on MT7610_AP
	default n

#config  MT7610_AP_EXT_CHANNEL_LIST
#	bool "Extension Channel List"
#	depends on MT7610_AP

#config  MT7610_AP_VIDEO_TURBINE
#	bool "Video Turbine support"
#	depends on MT7610_AP
#	default n

#config  MT7610_AP_GREENAP
#	bool "Green AP mode support"
#	depends on MT7610_AP

config  MT7610_AP_DLS
	bool "802.11e DLS (Direct-Link Setup) Support"
	depends on MT7610_AP
	default n

config  MT7610_AP_IDS
	bool "IDS (Intrusion Detection System) Support"
	depends on MT7610_AP
	default n

config  MT7610_AP_80211N_DRAFT3
	bool "802.11n Draft3"
	depends on MT7610_AP
	default n

config  MT7610_AP_IGMP_SNOOP
	bool "IGMP snooping"
	depends on MT7610_AP
	default n

config  MT7610_AP_MCAST_RATE_SPECIFIC
	bool "User specific TX rate of mcast packets"
	depends on MT7610_AP
	default n

#config  MT7610_AP_HDR_TRANS
#	bool "Header Translation Rx Support"
#	depends on MT7610_AP

#config  MT7610_AP_CSO
#	bool "CSO/TSO Support"
#	depends on MT7610_AP

choice
	prompt "Tx Power Compensation"
	depends on MT7610_AP
	default MT7610_AP_TEMPERATURE_COMPENSATION

	config MT7610_AP_TSSI_COMPENSATION
	bool "TSSI DC Calibration & TSSI compensation Support"

	config MT7610_AP_TEMPERATURE_COMPENSATION
	bool "Tx Power Temperature Compensation"
endchoice

config  MT7610_AP_SINGLE_SKU
	bool "Single SKU"
	depends on MT7610_AP

config  MT7610_AP_READ_MAC_FROM_MTD
	bool "Read and set MAC from MTD/EEPROM"
	depends on MT7610_AP
	default y

config  MT7610_AP_BIG_ENDIAN
	bool "Big-endian platform Support"
	depends on MT7610_AP
	default n

config  MT7610_AP_MC_SUPPORT
	bool "Multiple Card Support"
	default n
	depends on MT7610_AP

config  MT7610_AP_ATE
	bool "Provide ATE testmode commands support"
	depends on MT7610_AP
	default n

config  MT7610_AP_QA
	bool "Provide QA tool support"
	depends on MT7610_AP
	depends on MT7610_AP_ATE
	default n

config  MT7610_AP_DBG
	bool "Debug support for AP mode"
	depends on MT7610_AP
	default n
```

## trunk/proprietary/rt_wifi/rtpci/4.1.X.X/mt76x3_ap/Kconfig
```kconfig
config MT76X3_AP
	tristate "MediaTek MT7603E 802.11 AP driver"
	select WIRELESS_EXT
	select WEXT_SPY
	select WEXT_PRIV

config  MT76X3_AP_LED
	bool "LED support"
	depends on MT76X3_AP
	default y

config  MT76X3_AP_LED_SOFT
	bool "Soft LED support"
	depends on MT76X3_AP && !MT76X3_AP_LED && RALINK_GPIO_LED
	default n

config  MT76X3_AP_LED_SOFT_GPIO
	int "Soft LED GPIO pin"
	depends on MT76X3_AP && MT76X3_AP_LED_SOFT
	default -1

config  MT76X3_AP_LLTD
	bool "LLTD (Link Layer Topology Discovery Protocol)"
	depends on MT76X3_AP
	default y

config  MT76X3_AP_WDS
	bool "WDS support"
	depends on MT76X3_AP
	default y

config  MT76X3_AP_MBSS
	bool "MBSSID support"
	depends on MT76X3_AP
	default y

config  MT76X3_AP_APCLI
	bool "AP-Client support"
	depends on MT76X3_AP
	default y

config  MT76X3_AP_MULTI_APCLI
	bool "Multi AP-Client support"
	depends on MT76X3_AP
	depends on MT76X3_AP_APCLI
	default n

config  MT76X3_AP_MAC_REPEATER
	bool "MAC Repeater Mode support"
	depends on MT76X3_AP
	depends on MT76X3_AP_APCLI
	default n

config  MT76X3_AP_AIRPLAY
	bool "AirPlay support"
	depends on MT76X3_AP
	depends on MT76X3_AP_APCLI
	default n

#config  MT76X3_AP_DFS
#	bool "DFS support"
#	depends on MT76X3_AP
#	default n

config  MT76X3_AP_CARRIER
	bool "Carrier Detection support"
	depends on MT76X3_AP
	default n

config  MT76X3_AP_SMART_CARRIER_SENSE
	bool "Smart Carrier Sense support"
	depends on MT76X3_AP
	default y

config  MT76X3_AP_GREENAP
	bool "Green AP mode support"
	depends on MT76X3_AP
	default n

config  MT76X3_AP_IDS
	bool "IDS (Intrusion Detection System) support"
	depends on MT76X3_AP
	default y

config  MT76X3_AP_DLS
	bool "802.11e DLS (Direct-Link Setup) support"
	depends on MT76X3_AP
	default n

config MT76X3_AP_SINGLE_SKU
	bool "Single SKU regspec"
	depends on MT76X3_AP
	default n

config MT76X3_AP_DOT11R_FT
	bool "802.11r Fast BSS Transition support"
	depends on MT76X3_AP
	default y

config MT76X3_AP_DOT11K_RRM
	bool "802.11k Radio Resource Management support"
	depends on MT76X3_AP
	default y

config  MT76X3_AP_EXT_CHANNEL_LIST
	bool "Extension Channel List 802.11d compat"
	depends on MT76X3_AP
	default y

config MT76X3_AP_80211N_DRAFT3
	bool "802.11n Draft3 (BSS Coexistence)"
	depends on MT76X3_AP
	default n

config MT76X3_AP_80211W_PMF
	bool "802.11w Protected Management Frames (PMF) support"
	depends on MT76X3_AP
	default n

#config MT76X3_AP_WAPI
#	bool "WAPI support"
#	depends on MT76X3_AP
#	default n

config MT76X3_AP_WSC
	bool "WSC (WiFi Simple Config)"
	depends on MT76X3_AP
	default n

config MT76X3_AP_WSC_V2
	bool "WSC V2 (WiFi Simple Config Version 2)"
	depends on MT76X3_AP
	depends on MT76X3_AP_WSC
	default n

config MT76X3_AP_WSC_NFC
	bool "WSC out-of-band (NFC)"
	depends on MT76X3_AP
	depends on MT76X3_AP_WSC
	default n

config MT76X3_AP_ED_MONITOR
	bool "ED CCA Monitor support"
	depends on MT76X3_AP
	default n

config MT76X3_AP_IGMP_SNOOP
	bool "IGMP snooping (M2U in wireless driver)"
	depends on MT76X3_AP
	default n

config MT76X3_AP_MCAST_RATE_SPECIFIC
	bool "User specific TX rate of mcast packets"
	depends on MT76X3_AP
	default n

config MT76X3_AP_DELAYED_TCP_ACK
	bool "Delayed TCP ACK support"
	depends on MT76X3_AP
	default n

#config MT76X3_AP_HDR_TRANS
#	bool "Header Translation RX support"
#	depends on MT76X3_AP
#	default n

config MT76X3_AP_NETIF_BLOCK
	bool "NETIF Block"
	depends on MT76X3_AP
	default n
	help
	  Support Net interface block while Tx-Sw queue full

#config MT76X3_AP_VIDEO_TURBINE
#	bool "Video Turbine support"
#	depends on MT76X3_AP
#	default n

config MT76X3_AP_SNMP
	bool "Support SNMPD counters"
	depends on MT76X3_AP
	default y

#config MT76X3_AP_CFG80211
#	bool "CFG80211 support (Linux wireless configuration API)"
#	depends on MT76X3_AP
#	depends on CFG80211
#	default n

config MT76X3_AP_READ_MAC_FROM_MTD
	bool "Read and set MAC address from MTD/EEPROM"
	depends on MT76X3_AP
	default n

#config MT76X3_AP_MEMORY_OPTIMIZATION
#	bool "Memory optimization (shrink ring size). Need for < 32Mb RAM devices"
#	depends on MT76X3_AP
#	default n

#config MT76X3_AP_BIG_ENDIAN
#	bool "Big-endian platform support"
#	depends on MT76X3_AP
#	default n

#config MT76X3_AP_MC_SUPPORT
#	bool "Multiple PCIe card support"
#	depends on MT76X3_AP
#	default n

config MT76X3_AP_ATE
	bool "Provide ATE testmode commands support"
	depends on MT76X3_AP
	select MT76X3_AP_QA
	default n

config MT76X3_AP_QA
	bool "Provide QA tool support"
	depends on MT76X3_AP
	depends on MT76X3_AP_ATE
	default y

config MT76X3_AP_DEBUG
	bool "Include Debug messages"
	default n
```

## trunk/proprietary/rt_wifi/rtsoc/2.4.X.X/rt2860v2_ap/Kconfig
```kconfig
config RT2860V2_AP
	tristate "Ralink RT3883/RT3662 802.11 AP driver"
	select WIRELESS_EXT
	select WEXT_SPY
	select WEXT_PRIV

config  RT2860V2_AP_LED
	bool "LED support"
	depends on RT2860V2_AP
	default y

config  RT2860V2_AP_LLTD
	bool "LLTD (Link Layer Topology Discovery Protocol)"
	depends on RT2860V2_AP
	default y

config  RT2860V2_AP_WDS
	bool "WDS support"
	depends on RT2860V2_AP
	default y

config  RT2860V2_AP_WMM_ACM
	bool "WMM ACM"
	depends on RT2860V2_AP
	default n

config  RT2860V2_AP_MBSS
	bool "MBSSID support"
	depends on RT2860V2_AP
	default y

config  RT2860V2_AP_MBSS_NEW_MBSSID_MODE
	bool "New MBSSID mode"
	depends on RT2860V2_AP_MBSS
	depends on RALINK_RT3883 || RALINK_RT3352
	default n

config  RT2860V2_AP_APCLI
	bool "AP-Client support"
	depends on RT2860V2_AP

config  RT2860V2_AP_DFS
	bool "DFS"
	depends on RT2860V2_AP
	select RALINK_TIMER_DFS
	help
	  Support dynamic freqrency selection

config  RT2860V2_AP_CARRIER
	bool "Carrier Detect"
	depends on RT2860V2_AP
	select RALINK_TIMER_DFS
	help
	  Carrier Sense Multi-Access/Collision Detection.

config  RT2860V2_AP_DLS
	bool "DLS ((Direct-Link Setup) Support"
	depends on RT2860V2_AP

config  RT2860V2_AP_IDS
	bool "IDS (Intrusion Detection System) Support"
	depends on RT2860V2_AP

config  RT2860V2_AP_GREENAP
	bool "Green AP mode support"
	depends on RT2860V2_AP

config  RT2860V2_AP_TXBF
	bool "Tx Beam Forming Support (Only 3883)"
	depends on RT2860V2_AP
	depends on RALINK_RT3883
```
