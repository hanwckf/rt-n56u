## trunk/linux-3.4.x/ralink/Kconfig
```kconfig
menu "Ralink Module"

###########
# Debuging
###########
source "drivers/net/rt_rdm/Kconfig"

#############
# Switch
#############
if !(RALINK_RT5350 || RALINK_MT7628)
menu "External Ethernet Giga-Switch"
source "drivers/net/rtl8367/Kconfig"
endmenu
endif

#############
# Wired
#############
menu "Ralink Wired Ethernet Driver"
source "drivers/net/raeth/Kconfig"
endmenu

#############
# Wireless
#############
menu "Ralink Wireless 802.11 Support"

comment "1st Wireless Interface"

choice
	prompt "Choose 1st Wireless Interface"
	config RT_FIRST_IF_NONE
	bool "None"

	config RT_FIRST_IF_RT2860
	bool "RT2860v2 APSoC (RTMP driver 2.7.x.x)"
	depends on (RALINK_RT3052 || RALINK_RT3352 || RALINK_RT5350 || RALINK_RT3883 || RALINK_MT7620)

	config RT_FIRST_IF_MT7620
	bool "MT7620 APSoC (RLT driver 3.0.x.x)"
	depends on RALINK_MT7620

	config RT_FIRST_IF_MT7628
	bool "MT7628 APSoC (MT driver 4.0.x.x)"
	depends on RALINK_MT7628

	config RT_FIRST_IF_RT3090
	bool "RT3092 PCIe"
	depends on RALINK_MT7621

	config RT_FIRST_IF_RT5392
	bool "RT5392 PCIe"
	depends on RALINK_MT7621

	config RT_FIRST_IF_RT5592
	bool "RT5592 PCIe"
	depends on RALINK_MT7621

	config RT_FIRST_IF_RT3593
	bool "RT3593 PCIe"
	depends on RALINK_MT7621

	config RT_FIRST_IF_MT7610E
	bool "MT7610E PCIe"
	depends on RALINK_MT7621

	config RT_FIRST_IF_MT7602E
	bool "MT7602E PCIe"
	depends on RALINK_MT7621

	config RT_FIRST_IF_MT7612E
	bool "MT7612E PCIe"
	depends on RALINK_MT7621

	config RT_FIRST_IF_MT7603E
	bool "MT7603E PCIe"
	depends on RALINK_MT7621

	config RT_FIRST_IF_MT7615E
	bool "MT7615E PCIe"
	depends on RALINK_MT7621

	config RT_FIRST_IF_MT7915
	bool "MT7915 PCIe"
	depends on RALINK_MT7621
endchoice

choice
	prompt "Range of 1st Wireless Interface"
	depends on !RT_FIRST_IF_NONE

	config RT_FIRST_IF_RANGE_2GHZ
	bool "2.4 GHz"

	config RT_FIRST_IF_RANGE_5GHZ
	bool "5GHz"
	depends on (RT_FIRST_IF_RT2860 || RT_FIRST_IF_RT5592 || RT_FIRST_IF_RT3593 || RT_FIRST_IF_MT7610E || RT_FIRST_IF_MT7612E || RT_FIRST_IF_MT7615E || RT_FIRST_IF_MT7915)
endchoice

choice
	prompt "EEPROM Type of 1st Wireless Interface"
	depends on !RT_FIRST_IF_NONE

	config RT_FIRST_IF_EEPROM_FLASH
	bool "FLASH partition"

	config RT_FIRST_IF_EEPROM_EFUSE
	bool "eFUSE on-die"
	depends on !(RT_FIRST_IF_RT2860 || RT_FIRST_IF_MT7620 || RT_FIRST_IF_MT7628 || RT_FIRST_IF_MT7615E || RT_FIRST_IF_MT7915)

	config RT_FIRST_IF_EEPROM_PROM
	bool "EEPROM chip"
	depends on !(RT_FIRST_IF_RT2860 || RT_FIRST_IF_MT7620 || RT_FIRST_IF_MT7628 || RT_FIRST_IF_MT7615E || RT_FIRST_IF_MT7915)
endchoice

config  RT_FIRST_IF_RF_OFFSET
	hex "EEPROM FLASH Offset of 1st Wireless Interface"
	depends on RT_FIRST_IF_EEPROM_FLASH
	default 0x40000

config  RT_FIRST_CARD
	int
	default 0    if RT_FIRST_IF_NONE
	default 2860 if RT_FIRST_IF_RT2860
	default 3090 if RT_FIRST_IF_RT3090
	default 5392 if RT_FIRST_IF_RT5392
	default 5592 if RT_FIRST_IF_RT5592
	default 3593 if RT_FIRST_IF_RT3593
	default 7620 if RT_FIRST_IF_MT7620
	default 7628 if RT_FIRST_IF_MT7628
	default 7610 if RT_FIRST_IF_MT7610E
	default 7602 if RT_FIRST_IF_MT7602E
	default 7612 if RT_FIRST_IF_MT7612E
	default 7603 if RT_FIRST_IF_MT7603E
	default 7615 if RT_FIRST_IF_MT7615E
	default 7915 if RT_FIRST_IF_MT7915

config RT_FIRST_CARD_EEPROM
	string
	depends on !RT_FIRST_IF_NONE
	default "prom" if RT_FIRST_IF_EEPROM_PROM
	default "efuse" if RT_FIRST_IF_EEPROM_EFUSE
	default "flash" if RT_FIRST_IF_EEPROM_FLASH

comment "2nd Wireless Interface"

choice
	prompt "Choose 2nd Wireless Interface"
	config RT_SECOND_IF_NONE
	bool "None"

	config RT_SECOND_IF_RT3352_INIC
	bool "RT3352 iNIC MII"

	config RT_SECOND_IF_RT3090
	bool "RT3092 PCIe"

	config RT_SECOND_IF_RT5392
	bool "RT5392 PCIe"

	config RT_SECOND_IF_RT5592
	bool "RT5592 PCIe"

	config RT_SECOND_IF_RT3593
	bool "RT3593 PCIe"

	config RT_SECOND_IF_MT7610E
	bool "MT7610E PCIe"

	config RT_SECOND_IF_MT7602E
	bool "MT7602E PCIe"

	config RT_SECOND_IF_MT7612E
	bool "MT7612E PCIe"

	config RT_SECOND_IF_MT7603E
	bool "MT7603E PCIe"

	config RT_SECOND_IF_MT7615E
	bool "MT7615E PCIe"

	config RT_SECOND_IF_MT7915
	bool "MT7915 PCIe"
endchoice

choice
	prompt "Range of 2nd Wireless Interface"
	depends on !RT_SECOND_IF_NONE

	config RT_SECOND_IF_RANGE_2GHZ
	bool "2.4 GHz"

	config RT_SECOND_IF_RANGE_5GHZ
	bool "5GHz"
	depends on (RT_SECOND_IF_RT5592 || RT_SECOND_IF_RT3593 || RT_SECOND_IF_MT7610E || RT_SECOND_IF_MT7612E || RT_SECOND_IF_MT7615E || RT_SECOND_IF_MT7915)
endchoice

choice
	prompt "EEPROM Type of 2nd Wireless Interface"
	depends on !(RT_SECOND_IF_NONE || RT_SECOND_IF_RT3352_INIC)

	config RT_SECOND_IF_EEPROM_FLASH
	bool "FLASH partition"

	config RT_SECOND_IF_EEPROM_EFUSE
	bool "eFUSE on-die"

	config RT_SECOND_IF_EEPROM_PROM
	bool "EEPROM chip"
endchoice

config  RT_SECOND_IF_RF_OFFSET
	hex "EEPROM FLASH Offset of 2nd Wireless Interface"
	depends on RT_SECOND_IF_EEPROM_FLASH
	default 0x48000

config  RT_SECOND_CARD
	int
	default 0    if RT_SECOND_IF_NONE
	default 3352 if RT_SECOND_IF_RT3352_INIC
	default 3090 if RT_SECOND_IF_RT3090
	default 5392 if RT_SECOND_IF_RT5392
	default 5592 if RT_SECOND_IF_RT5592
	default 3593 if RT_SECOND_IF_RT3593
	default 7610 if RT_SECOND_IF_MT7610E
	default 7602 if RT_SECOND_IF_MT7602E
	default 7612 if RT_SECOND_IF_MT7612E
	default 7603 if RT_SECOND_IF_MT7603E
	default 7615 if RT_SECOND_IF_MT7615E
	default 7915 if RT_SECOND_IF_MT7915

config RT_SECOND_CARD_EEPROM
	string
	depends on !RT_SECOND_IF_NONE
	default "prom" if RT_SECOND_IF_EEPROM_PROM
	default "efuse" if RT_SECOND_IF_EEPROM_EFUSE
	default "flash" if RT_SECOND_IF_EEPROM_FLASH

comment "3rd Wireless Interface"

choice
	prompt "Choose 3rd Wireless Interface"
	config RT_THIRD_IF_NONE
	bool "None"

	config RT_THIRD_IF_MT7615E
	bool "MT7615E PCIe"

	config RT_THIRD_IF_MT7915
	bool "MT7915 PCIe"
endchoice

config RT_THIRD_CARD
	int
	default 0    if RT_THIRD_IF_NONE
	default 7615 if RT_THIRD_IF_MT7615E
	default 7915 if RT_THIRD_IF_MT7915

choice
	prompt "Range of 3rd Wireless Interface"
	depends on !RT_THIRD_IF_NONE

	config RT_THIRD_IF_RANGE_2GHZ
	bool "2.4GHz"

	config RT_THIRD_IF_RANGE_5GHZ
	bool "5GHz"
endchoice

choice
	prompt "EEPROM Type of 3rd Wireless Interface"
	depends on !(RT_THIRD_IF_NONE)

	config RT_THIRD_IF_EEPROM_FLASH
	bool "FLASH partition"

	config RT_THIRD_IF_EEPROM_EFUSE
	bool "eFUSE on-die"

	config RT_THIRD_IF_EEPROM_PROM
	bool "EEPROM chip"
endchoice

config RT_THIRD_IF_RF_OFFSET
	hex "EEPROM FLASH Offset of 3rd Wireless Interface"
	depends on RT_THIRD_IF_EEPROM_FLASH
	default 0x50000

config RT_THIRD_CARD_EEPROM
	string
	depends on !RT_THIRD_IF_NONE
	default "prom" if RT_THIRD_IF_EEPROM_PROM
	default "efuse" if RT_THIRD_IF_EEPROM_EFUSE
	default "flash" if RT_THIRD_IF_EEPROM_FLASH


comment "Wireless drivers settings"
	depends on (!RT_FIRST_IF_NONE || !RT_SECOND_IF_NONE)

if RT_FIRST_IF_RT2860
choice
	prompt "APSoC RF Type"
	depends on RALINK_RT5350
	default RALINK_RT5350_1T1R

	config  RALINK_RT5350_1T1R
	bool "1T1R"
endchoice

choice
	prompt "APSoC RF Type"
	depends on RALINK_RT3052
	default RALINK_RT3052_2T2R

	config  RALINK_RT3050_1T1R
	bool "1T1R"

	config  RALINK_RT3051_1T2R
	bool "1T2R"

	config  RALINK_RT3052_2T2R
	bool "2T2R"
endchoice

choice
	prompt "APSoC RF Type"
	depends on RALINK_RT3352

	config  RALINK_RT3352_2T2R
	bool "2T2R"
endchoice

choice
	prompt "APSoC RF Type"
	depends on RALINK_RT3883

	config  RALINK_RT3662_2T2R
	bool "2T2R or 2T3R (RT3662)"

	config  RALINK_RT3883_3T3R
	bool "3T3R (RT3883)"
endchoice

menu "AP MODE Ralink RT3xxx/RT5xxx/MT7620 APSoC Wireless driver"
source "drivers/net/wireless/ralink/rt2860v2_ap/Kconfig"
endmenu
endif

if (RT_FIRST_IF_MT7628)
menu "AP MODE MediaTek MT7628/MT7688 RBUS Wireless driver"
source "drivers/net/wireless/ralink/mt7628_ap/Kconfig"
endmenu
endif

if (RT_SECOND_IF_RT3352_INIC)
menu "AP MODE Ralink RT3352 iNIC MII Wireless driver"
source "drivers/net/wireless/ralink/rt3352_mii/Kconfig"
endmenu
endif

if (RT_FIRST_IF_RT3090 || RT_SECOND_IF_RT3090)
menu "AP MODE Ralink RT309x PCIe Wireless driver"
source "drivers/net/wireless/ralink/rt3090_ap/Kconfig"
endmenu
endif

if (RT_FIRST_IF_RT5392 || RT_SECOND_IF_RT5392)
menu "AP MODE Ralink RT5392 PCIe Wireless driver"
source "drivers/net/wireless/ralink/rt5392_ap/Kconfig"
endmenu
endif

if (RT_FIRST_IF_RT5592 || RT_SECOND_IF_RT5592)
menu "AP MODE Ralink RT5592 PCIe Wireless driver"
source "drivers/net/wireless/ralink/rt5592_ap/Kconfig"
endmenu
endif

if (RT_FIRST_IF_RT3593 || RT_SECOND_IF_RT3593)
menu "AP MODE Ralink RT3593 PCIe Wireless driver"
source "drivers/net/wireless/ralink/rt3593_ap/Kconfig"
endmenu
endif

if (RT_FIRST_IF_MT7610E || RT_SECOND_IF_MT7610E)
menu "AP MODE MediaTek MT7610E PCIe Wireless driver"
source "drivers/net/wireless/ralink/mt7610_ap/Kconfig"
endmenu
endif

if (RT_FIRST_IF_MT7620 || RT_FIRST_IF_MT7612E || RT_FIRST_IF_MT7602E || RT_SECOND_IF_MT7612E || RT_SECOND_IF_MT7602E)
menu "AP MODE MediaTek MT7620/MT7602E/MT7612E RBUS/PCIe Wireless driver"
source "drivers/net/wireless/ralink/mt76x2_ap/Kconfig"
endmenu
endif

if (RT_FIRST_IF_MT7603E || RT_SECOND_IF_MT7603E)
menu "AP MODE MediaTek MT7603E PCIe Wireless driver"
source "drivers/net/wireless/ralink/mt76x3/Kconfig"
endmenu
endif

if (RT_FIRST_IF_MT7615E || RT_SECOND_IF_MT7615E || RT_FIRST_IF_MT7915 || RT_SECOND_IF_MT7915)
menu "MT7615/MT7915 common configs"

choice
        prompt "PA LNA Type of 1st Card"
		depends on ! RT_FIRST_IF_NONE
		
		config FIRST_IF_EPAELNA
		bool "ePAeLNA"
		config FIRST_IF_IPAILNA
		bool "iPAiLNA"		
		config FIRST_IF_IPAELNA
		bool "iPAeLNA"
#		config FIRST_IF_EPAILNA
#		bool "ePAiLNA"
endchoice

choice
        prompt "PA LNA Type of 2nd Card"
		depends on ! RT_SECOND_IF_NONE
		
		config SECOND_IF_EPAELNA
		bool "ePAeLNA"
		config SECOND_IF_IPAILNA
		bool "iPAiLNA"		
		config SECOND_IF_IPAELNA
		bool "iPAeLNA"
#		config SECOND_IF_EPAILNA
#		bool "ePAiLNA"
endchoice

choice
        prompt "PA LNA Type of 3rd Card"
		depends on ! RT_THIRD_IF_NONE
		
		config THIRD_IF_EPAELNA
		bool "ePAeLNA"
		config THIRD_IF_IPAILNA
		bool "iPAiLNA"		
		config THIRD_IF_IPAELNA
		bool "iPAeLNA"
#		config THIRD_IF_EPAILNA
#		bool "ePAiLNA"
endchoice

choice
	prompt "Main Mode"
	default WIFI_MODE_AP

	config WIFI_MODE_AP
			tristate "AP"
			select MT_AP_SUPPORT

	config WIFI_MODE_STA
			tristate "STA"
			select MT_STA_SUPPORT

	config WIFI_MODE_BOTH
			tristate "APSTA"
			select MT_AP_SUPPORT
			select MT_STA_SUPPORT
endchoice

endmenu
endif

if (RT_FIRST_IF_MT7615E || RT_SECOND_IF_MT7615E)
menu "AP MODE MediaTek MT7615E PCIe Wireless driver"
source "drivers/net/wireless/ralink/mt7615/embedded/Kconfig"
endmenu
endif

if (RT_FIRST_IF_MT7915 || RT_SECOND_IF_MT7915)
menu "AP MODE MediaTek MT7915 PCIe Wireless driver"
source "drivers/net/wireless/ralink/mt7915/embedded/Kconfig"
endmenu
endif

if (!RT_FIRST_IF_NONE || !RT_SECOND_IF_NONE)
if !(RT_FIRST_IF_MT7603E && RT_SECOND_IF_MT7615E) && !(RT_FIRST_IF_MT7615E && RT_SECOND_IF_MT7603E) && !(RT_FIRST_IF_MT7615E && RT_SECOND_IF_NONE) && !(RT_FIRST_IF_MT7615E && RT_SECOND_IF_MT7615E) && !(RT_FIRST_IF_MT7915 || RT_SECOND_IF_MT7915)
menu "Wireless drivers common configs"
source "drivers/net/wireless/ralink/Kconfig"
endmenu
endif
endif

endmenu

#######
# NAT
#######
menu "Ralink NAT Acceleration Mode"
choice
	prompt "Ralink Hardware NAT mode"

	config RA_NAT_NONE
	bool "Disable NAT acceleration"

	config RA_NAT_HW
	bool "Hardware NAT acceleration"
	depends on !(RALINK_RT5350 || RALINK_MT7628)
endchoice

if RA_NAT_HW
source "net/nat/hw_nat/Kconfig"
endif
endmenu

#######
# HWCRYPTO
#######
menu "Ralink HW Crypto"
source "drivers/net/rt_eip/Kconfig"
endmenu

#######
# DEV
#######
menu "Ralink Peripheral Devices"
config RT3XXX_EHCI_OHCI
	bool "Ralink USB2 EHCI/OHCI controller support"
	depends on (RALINK_RT3883 || RALINK_RT3352 || RALINK_RT5350 || RALINK_MT7620 || RALINK_MT7628)
	select USB_ARCH_HAS_OHCI
	select USB_ARCH_HAS_EHCI

config MTK_XHCI
	bool "MediaTek USB3/USB2/USB1.1 xHCI controller support"
	depends on (RALINK_MT7621)
	select USB_ARCH_HAS_XHCI

# used only for iNIC_mii binary blob (need align Linux kernel structures to original environment)
config RTDEV_MII
	bool
	default y if RT3352_INIC_MII
endmenu

endmenu
```

## trunk/patches/rt3883-asus/linux-2.6.21.x/drivers/nvram/Kconfig
```kconfig
menu "ASUS NVRAM"

config	ASUS_NVRAM_API
	tristate "ASUS NVRAM R/W API"
	default y
	---help---
	ASUS NVRAM R/W API
endmenu
```

## trunk/patches/rt3883-wifi/linux-2.6.21.x/drivers/net/wireless/rt3090_ap/Kconfig
```kconfig
config RT3090_AP
	tristate "Ralink RT3090 802.11n AP support"
	depends on NET_RADIO 
	
config  RT3090_AP_WSC
	bool "WSC (WiFi Simple Config)"
	depends on RT3090_AP

config  RT3090_AP_LLTD
	bool "LLTD (Link Layer Topology Discovery Protocol)"
	depends on RT3090_AP

config  RT3090_AP_WDS
	bool "WDS"
	depends on RT3090_AP

# ASUS EXT
config  RT3090_AP_WMM_ACM
	bool "WMM ACM"
	depends on RT3090_AP

config  RT3090_AP_MBSS
	bool "MBSSID"
	depends on RT3090_AP

#config  RT3090_AP_APCLI
#	bool "AP-CLient Support"
#	depends on RT3090_AP

config  RT3090_AP_IGMP_SNOOP
	bool "IGMP snooping"
	depends on RT3090_AP

config  RT3090_AP_NETIF_BLOCK
	bool "NETIF Block"
	depends on RT3090_AP
	help
	Support Net interface block while Tx-Sw queue full

#config  RT3090_AP_DFS
#	bool "DFS"
#	depends on RT3090_AP
#	select RALINK_TIMER_DFS

#config  RT3090_AP_CARRIER
#	bool "Carrier Detect"
#	depends on RT3090_AP
#	select RALINK_TIMER_DFS

config  RT3090_AP_DLS
	bool "DLS ((Direct-Link Setup) Support"
	depends on RT3090_AP

#config  RT3090_AP_IDS
#	bool "IDS (Intrusion Detection System) Support"
#	depends on RT3090_AP

config  RT3090_80211N_DRAFT3
	bool "802.11n Draft3"
	depends on RT3090_AP

config  RT3090_AP_BRIDGE_FASTPATH
	bool "Bridge wlan2lan operation offload"
	depends on RT3090_AP

config  RT3090_AP_ATE
	bool "Provide ATE+QA testmode commands support"
	depends on RT3090_AP
	default y

config RALINK_RT3090_AP_DBG
        bool "Debug support for AP mode"
	default n
	depends on RT3090_AP
```

## trunk/proprietary/rt_wifi/rtpci/2.5.X.X/rt3090_ap/Kconfig
```kconfig
config RT3090_AP
	tristate "Ralink RT309X 802.11 AP driver"
	select WIRELESS_EXT
	select WEXT_SPY
	select WEXT_PRIV

config  RT3090_AP_RT3390
	bool "RT3390 support"
	depends on RT3090_AP
	default n

config  RT3090_AP_LED
	bool "LED support"
	depends on RT3090_AP
	default y

config  RT3090_AP_LLTD
	bool "LLTD (Link Layer Topology Discovery Protocol)"
	depends on RT3090_AP
	default y

config  RT3090_AP_WDS
	bool "WDS support"
	depends on RT3090_AP
	default y

config  RT3090_AP_WMM_ACM
	bool "WMM ACM"
	depends on RT3090_AP
	default n

config  RT3090_AP_MBSS
	bool "MBSSID support"
	depends on RT3090_AP
	default y

config  RT3090_AP_APCLI
	bool "AP-Client support"
	depends on RT3090_AP
	default y

config  RT3090_AP_DLS
	bool "DLS (Direct-Link Setup) support"
	depends on RT3090_AP
	default n

config  RT3090_AP_IDS
	bool "IDS (Intrusion Detection System) support"
	depends on RT3090_AP
	default n

config  RT3090_AP_GREENAP
	bool "Green AP mode support"
	depends on RT3090_AP
	default y
```
